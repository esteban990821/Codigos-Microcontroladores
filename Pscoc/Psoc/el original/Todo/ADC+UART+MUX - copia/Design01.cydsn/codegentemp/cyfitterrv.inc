;
; File Name: cyfitterrv.inc
; 
; PSoC Creator  4.2
;
; Description:
; 
;
;-------------------------------------------------------------------------------
; Copyright (c) 2007-2018 Cypress Semiconductor.  All rights reserved.
; You may use this file only in accordance with the license, terms, conditions, 
; disclaimers, and limitations in the end user license agreement accompanying 
; the software package with which this file was provided.
;-------------------------------------------------------------------------------

    IF :LNOT::DEF:INCLUDED_CYFITTERRV_INC
INCLUDED_CYFITTERRV_INC EQU 1
    GET cydevicerv.inc
    GET cydevicerv_trm.inc

; A0
A0__0__INTTYPE EQU CYREG_PICU0_INTTYPE0
A0__0__MASK EQU 0x01
A0__0__PC EQU CYREG_PRT0_PC0
A0__0__PORT EQU 0
A0__0__SHIFT EQU 0
A0__AG EQU CYREG_PRT0_AG
A0__AMUX EQU CYREG_PRT0_AMUX
A0__BIE EQU CYREG_PRT0_BIE
A0__BIT_MASK EQU CYREG_PRT0_BIT_MASK
A0__BYP EQU CYREG_PRT0_BYP
A0__CTL EQU CYREG_PRT0_CTL
A0__DM0 EQU CYREG_PRT0_DM0
A0__DM1 EQU CYREG_PRT0_DM1
A0__DM2 EQU CYREG_PRT0_DM2
A0__DR EQU CYREG_PRT0_DR
A0__INP_DIS EQU CYREG_PRT0_INP_DIS
A0__INTTYPE_BASE EQU CYDEV_PICU_INTTYPE_PICU0_BASE
A0__LCD_COM_SEG EQU CYREG_PRT0_LCD_COM_SEG
A0__LCD_EN EQU CYREG_PRT0_LCD_EN
A0__MASK EQU 0x01
A0__PORT EQU 0
A0__PRT EQU CYREG_PRT0_PRT
A0__PRTDSI__CAPS_SEL EQU CYREG_PRT0_CAPS_SEL
A0__PRTDSI__DBL_SYNC_IN EQU CYREG_PRT0_DBL_SYNC_IN
A0__PRTDSI__OE_SEL0 EQU CYREG_PRT0_OE_SEL0
A0__PRTDSI__OE_SEL1 EQU CYREG_PRT0_OE_SEL1
A0__PRTDSI__OUT_SEL0 EQU CYREG_PRT0_OUT_SEL0
A0__PRTDSI__OUT_SEL1 EQU CYREG_PRT0_OUT_SEL1
A0__PRTDSI__SYNC_OUT EQU CYREG_PRT0_SYNC_OUT
A0__PS EQU CYREG_PRT0_PS
A0__SHIFT EQU 0
A0__SLW EQU CYREG_PRT0_SLW

; A1
A1__0__INTTYPE EQU CYREG_PICU0_INTTYPE1
A1__0__MASK EQU 0x02
A1__0__PC EQU CYREG_PRT0_PC1
A1__0__PORT EQU 0
A1__0__SHIFT EQU 1
A1__AG EQU CYREG_PRT0_AG
A1__AMUX EQU CYREG_PRT0_AMUX
A1__BIE EQU CYREG_PRT0_BIE
A1__BIT_MASK EQU CYREG_PRT0_BIT_MASK
A1__BYP EQU CYREG_PRT0_BYP
A1__CTL EQU CYREG_PRT0_CTL
A1__DM0 EQU CYREG_PRT0_DM0
A1__DM1 EQU CYREG_PRT0_DM1
A1__DM2 EQU CYREG_PRT0_DM2
A1__DR EQU CYREG_PRT0_DR
A1__INP_DIS EQU CYREG_PRT0_INP_DIS
A1__INTTYPE_BASE EQU CYDEV_PICU_INTTYPE_PICU0_BASE
A1__LCD_COM_SEG EQU CYREG_PRT0_LCD_COM_SEG
A1__LCD_EN EQU CYREG_PRT0_LCD_EN
A1__MASK EQU 0x02
A1__PORT EQU 0
A1__PRT EQU CYREG_PRT0_PRT
A1__PRTDSI__CAPS_SEL EQU CYREG_PRT0_CAPS_SEL
A1__PRTDSI__DBL_SYNC_IN EQU CYREG_PRT0_DBL_SYNC_IN
A1__PRTDSI__OE_SEL0 EQU CYREG_PRT0_OE_SEL0
A1__PRTDSI__OE_SEL1 EQU CYREG_PRT0_OE_SEL1
A1__PRTDSI__OUT_SEL0 EQU CYREG_PRT0_OUT_SEL0
A1__PRTDSI__OUT_SEL1 EQU CYREG_PRT0_OUT_SEL1
A1__PRTDSI__SYNC_OUT EQU CYREG_PRT0_SYNC_OUT
A1__PS EQU CYREG_PRT0_PS
A1__SHIFT EQU 1
A1__SLW EQU CYREG_PRT0_SLW

; A2
A2__0__INTTYPE EQU CYREG_PICU0_INTTYPE2
A2__0__MASK EQU 0x04
A2__0__PC EQU CYREG_PRT0_PC2
A2__0__PORT EQU 0
A2__0__SHIFT EQU 2
A2__AG EQU CYREG_PRT0_AG
A2__AMUX EQU CYREG_PRT0_AMUX
A2__BIE EQU CYREG_PRT0_BIE
A2__BIT_MASK EQU CYREG_PRT0_BIT_MASK
A2__BYP EQU CYREG_PRT0_BYP
A2__CTL EQU CYREG_PRT0_CTL
A2__DM0 EQU CYREG_PRT0_DM0
A2__DM1 EQU CYREG_PRT0_DM1
A2__DM2 EQU CYREG_PRT0_DM2
A2__DR EQU CYREG_PRT0_DR
A2__INP_DIS EQU CYREG_PRT0_INP_DIS
A2__INTTYPE_BASE EQU CYDEV_PICU_INTTYPE_PICU0_BASE
A2__LCD_COM_SEG EQU CYREG_PRT0_LCD_COM_SEG
A2__LCD_EN EQU CYREG_PRT0_LCD_EN
A2__MASK EQU 0x04
A2__PORT EQU 0
A2__PRT EQU CYREG_PRT0_PRT
A2__PRTDSI__CAPS_SEL EQU CYREG_PRT0_CAPS_SEL
A2__PRTDSI__DBL_SYNC_IN EQU CYREG_PRT0_DBL_SYNC_IN
A2__PRTDSI__OE_SEL0 EQU CYREG_PRT0_OE_SEL0
A2__PRTDSI__OE_SEL1 EQU CYREG_PRT0_OE_SEL1
A2__PRTDSI__OUT_SEL0 EQU CYREG_PRT0_OUT_SEL0
A2__PRTDSI__OUT_SEL1 EQU CYREG_PRT0_OUT_SEL1
A2__PRTDSI__SYNC_OUT EQU CYREG_PRT0_SYNC_OUT
A2__PS EQU CYREG_PRT0_PS
A2__SHIFT EQU 2
A2__SLW EQU CYREG_PRT0_SLW

; A3
A3__0__INTTYPE EQU CYREG_PICU0_INTTYPE5
A3__0__MASK EQU 0x20
A3__0__PC EQU CYREG_PRT0_PC5
A3__0__PORT EQU 0
A3__0__SHIFT EQU 5
A3__AG EQU CYREG_PRT0_AG
A3__AMUX EQU CYREG_PRT0_AMUX
A3__BIE EQU CYREG_PRT0_BIE
A3__BIT_MASK EQU CYREG_PRT0_BIT_MASK
A3__BYP EQU CYREG_PRT0_BYP
A3__CTL EQU CYREG_PRT0_CTL
A3__DM0 EQU CYREG_PRT0_DM0
A3__DM1 EQU CYREG_PRT0_DM1
A3__DM2 EQU CYREG_PRT0_DM2
A3__DR EQU CYREG_PRT0_DR
A3__INP_DIS EQU CYREG_PRT0_INP_DIS
A3__INTTYPE_BASE EQU CYDEV_PICU_INTTYPE_PICU0_BASE
A3__LCD_COM_SEG EQU CYREG_PRT0_LCD_COM_SEG
A3__LCD_EN EQU CYREG_PRT0_LCD_EN
A3__MASK EQU 0x20
A3__PORT EQU 0
A3__PRT EQU CYREG_PRT0_PRT
A3__PRTDSI__CAPS_SEL EQU CYREG_PRT0_CAPS_SEL
A3__PRTDSI__DBL_SYNC_IN EQU CYREG_PRT0_DBL_SYNC_IN
A3__PRTDSI__OE_SEL0 EQU CYREG_PRT0_OE_SEL0
A3__PRTDSI__OE_SEL1 EQU CYREG_PRT0_OE_SEL1
A3__PRTDSI__OUT_SEL0 EQU CYREG_PRT0_OUT_SEL0
A3__PRTDSI__OUT_SEL1 EQU CYREG_PRT0_OUT_SEL1
A3__PRTDSI__SYNC_OUT EQU CYREG_PRT0_SYNC_OUT
A3__PS EQU CYREG_PRT0_PS
A3__SHIFT EQU 5
A3__SLW EQU CYREG_PRT0_SLW

; A4
A4__0__INTTYPE EQU CYREG_PICU0_INTTYPE6
A4__0__MASK EQU 0x40
A4__0__PC EQU CYREG_PRT0_PC6
A4__0__PORT EQU 0
A4__0__SHIFT EQU 6
A4__AG EQU CYREG_PRT0_AG
A4__AMUX EQU CYREG_PRT0_AMUX
A4__BIE EQU CYREG_PRT0_BIE
A4__BIT_MASK EQU CYREG_PRT0_BIT_MASK
A4__BYP EQU CYREG_PRT0_BYP
A4__CTL EQU CYREG_PRT0_CTL
A4__DM0 EQU CYREG_PRT0_DM0
A4__DM1 EQU CYREG_PRT0_DM1
A4__DM2 EQU CYREG_PRT0_DM2
A4__DR EQU CYREG_PRT0_DR
A4__INP_DIS EQU CYREG_PRT0_INP_DIS
A4__INTTYPE_BASE EQU CYDEV_PICU_INTTYPE_PICU0_BASE
A4__LCD_COM_SEG EQU CYREG_PRT0_LCD_COM_SEG
A4__LCD_EN EQU CYREG_PRT0_LCD_EN
A4__MASK EQU 0x40
A4__PORT EQU 0
A4__PRT EQU CYREG_PRT0_PRT
A4__PRTDSI__CAPS_SEL EQU CYREG_PRT0_CAPS_SEL
A4__PRTDSI__DBL_SYNC_IN EQU CYREG_PRT0_DBL_SYNC_IN
A4__PRTDSI__OE_SEL0 EQU CYREG_PRT0_OE_SEL0
A4__PRTDSI__OE_SEL1 EQU CYREG_PRT0_OE_SEL1
A4__PRTDSI__OUT_SEL0 EQU CYREG_PRT0_OUT_SEL0
A4__PRTDSI__OUT_SEL1 EQU CYREG_PRT0_OUT_SEL1
A4__PRTDSI__SYNC_OUT EQU CYREG_PRT0_SYNC_OUT
A4__PS EQU CYREG_PRT0_PS
A4__SHIFT EQU 6
A4__SLW EQU CYREG_PRT0_SLW

; A5
A5__0__INTTYPE EQU CYREG_PICU0_INTTYPE4
A5__0__MASK EQU 0x10
A5__0__PC EQU CYREG_PRT0_PC4
A5__0__PORT EQU 0
A5__0__SHIFT EQU 4
A5__AG EQU CYREG_PRT0_AG
A5__AMUX EQU CYREG_PRT0_AMUX
A5__BIE EQU CYREG_PRT0_BIE
A5__BIT_MASK EQU CYREG_PRT0_BIT_MASK
A5__BYP EQU CYREG_PRT0_BYP
A5__CTL EQU CYREG_PRT0_CTL
A5__DM0 EQU CYREG_PRT0_DM0
A5__DM1 EQU CYREG_PRT0_DM1
A5__DM2 EQU CYREG_PRT0_DM2
A5__DR EQU CYREG_PRT0_DR
A5__INP_DIS EQU CYREG_PRT0_INP_DIS
A5__INTTYPE_BASE EQU CYDEV_PICU_INTTYPE_PICU0_BASE
A5__LCD_COM_SEG EQU CYREG_PRT0_LCD_COM_SEG
A5__LCD_EN EQU CYREG_PRT0_LCD_EN
A5__MASK EQU 0x10
A5__PORT EQU 0
A5__PRT EQU CYREG_PRT0_PRT
A5__PRTDSI__CAPS_SEL EQU CYREG_PRT0_CAPS_SEL
A5__PRTDSI__DBL_SYNC_IN EQU CYREG_PRT0_DBL_SYNC_IN
A5__PRTDSI__OE_SEL0 EQU CYREG_PRT0_OE_SEL0
A5__PRTDSI__OE_SEL1 EQU CYREG_PRT0_OE_SEL1
A5__PRTDSI__OUT_SEL0 EQU CYREG_PRT0_OUT_SEL0
A5__PRTDSI__OUT_SEL1 EQU CYREG_PRT0_OUT_SEL1
A5__PRTDSI__SYNC_OUT EQU CYREG_PRT0_SYNC_OUT
A5__PS EQU CYREG_PRT0_PS
A5__SHIFT EQU 4
A5__SLW EQU CYREG_PRT0_SLW

; A6
A6__0__INTTYPE EQU CYREG_PICU15_INTTYPE4
A6__0__MASK EQU 0x10
A6__0__PC EQU CYREG_IO_PC_PRT15_PC4
A6__0__PORT EQU 15
A6__0__SHIFT EQU 4
A6__AG EQU CYREG_PRT15_AG
A6__AMUX EQU CYREG_PRT15_AMUX
A6__BIE EQU CYREG_PRT15_BIE
A6__BIT_MASK EQU CYREG_PRT15_BIT_MASK
A6__BYP EQU CYREG_PRT15_BYP
A6__CTL EQU CYREG_PRT15_CTL
A6__DM0 EQU CYREG_PRT15_DM0
A6__DM1 EQU CYREG_PRT15_DM1
A6__DM2 EQU CYREG_PRT15_DM2
A6__DR EQU CYREG_PRT15_DR
A6__INP_DIS EQU CYREG_PRT15_INP_DIS
A6__INTTYPE_BASE EQU CYDEV_PICU_INTTYPE_PICU15_BASE
A6__LCD_COM_SEG EQU CYREG_PRT15_LCD_COM_SEG
A6__LCD_EN EQU CYREG_PRT15_LCD_EN
A6__MASK EQU 0x10
A6__PORT EQU 15
A6__PRT EQU CYREG_PRT15_PRT
A6__PRTDSI__CAPS_SEL EQU CYREG_PRT15_CAPS_SEL
A6__PRTDSI__DBL_SYNC_IN EQU CYREG_PRT15_DBL_SYNC_IN
A6__PRTDSI__OE_SEL0 EQU CYREG_PRT15_OE_SEL0
A6__PRTDSI__OE_SEL1 EQU CYREG_PRT15_OE_SEL1
A6__PRTDSI__OUT_SEL0 EQU CYREG_PRT15_OUT_SEL0
A6__PRTDSI__OUT_SEL1 EQU CYREG_PRT15_OUT_SEL1
A6__PRTDSI__SYNC_OUT EQU CYREG_PRT15_SYNC_OUT
A6__PS EQU CYREG_PRT15_PS
A6__SHIFT EQU 4
A6__SLW EQU CYREG_PRT15_SLW

; A7
A7__0__INTTYPE EQU CYREG_PICU2_INTTYPE4
A7__0__MASK EQU 0x10
A7__0__PC EQU CYREG_PRT2_PC4
A7__0__PORT EQU 2
A7__0__SHIFT EQU 4
A7__AG EQU CYREG_PRT2_AG
A7__AMUX EQU CYREG_PRT2_AMUX
A7__BIE EQU CYREG_PRT2_BIE
A7__BIT_MASK EQU CYREG_PRT2_BIT_MASK
A7__BYP EQU CYREG_PRT2_BYP
A7__CTL EQU CYREG_PRT2_CTL
A7__DM0 EQU CYREG_PRT2_DM0
A7__DM1 EQU CYREG_PRT2_DM1
A7__DM2 EQU CYREG_PRT2_DM2
A7__DR EQU CYREG_PRT2_DR
A7__INP_DIS EQU CYREG_PRT2_INP_DIS
A7__INTTYPE_BASE EQU CYDEV_PICU_INTTYPE_PICU2_BASE
A7__LCD_COM_SEG EQU CYREG_PRT2_LCD_COM_SEG
A7__LCD_EN EQU CYREG_PRT2_LCD_EN
A7__MASK EQU 0x10
A7__PORT EQU 2
A7__PRT EQU CYREG_PRT2_PRT
A7__PRTDSI__CAPS_SEL EQU CYREG_PRT2_CAPS_SEL
A7__PRTDSI__DBL_SYNC_IN EQU CYREG_PRT2_DBL_SYNC_IN
A7__PRTDSI__OE_SEL0 EQU CYREG_PRT2_OE_SEL0
A7__PRTDSI__OE_SEL1 EQU CYREG_PRT2_OE_SEL1
A7__PRTDSI__OUT_SEL0 EQU CYREG_PRT2_OUT_SEL0
A7__PRTDSI__OUT_SEL1 EQU CYREG_PRT2_OUT_SEL1
A7__PRTDSI__SYNC_OUT EQU CYREG_PRT2_SYNC_OUT
A7__PS EQU CYREG_PRT2_PS
A7__SHIFT EQU 4
A7__SLW EQU CYREG_PRT2_SLW

; D0
D0__0__INTTYPE EQU CYREG_PICU1_INTTYPE2
D0__0__MASK EQU 0x04
D0__0__PC EQU CYREG_PRT1_PC2
D0__0__PORT EQU 1
D0__0__SHIFT EQU 2
D0__AG EQU CYREG_PRT1_AG
D0__AMUX EQU CYREG_PRT1_AMUX
D0__BIE EQU CYREG_PRT1_BIE
D0__BIT_MASK EQU CYREG_PRT1_BIT_MASK
D0__BYP EQU CYREG_PRT1_BYP
D0__CTL EQU CYREG_PRT1_CTL
D0__DM0 EQU CYREG_PRT1_DM0
D0__DM1 EQU CYREG_PRT1_DM1
D0__DM2 EQU CYREG_PRT1_DM2
D0__DR EQU CYREG_PRT1_DR
D0__INP_DIS EQU CYREG_PRT1_INP_DIS
D0__INTTYPE_BASE EQU CYDEV_PICU_INTTYPE_PICU1_BASE
D0__LCD_COM_SEG EQU CYREG_PRT1_LCD_COM_SEG
D0__LCD_EN EQU CYREG_PRT1_LCD_EN
D0__MASK EQU 0x04
D0__PORT EQU 1
D0__PRT EQU CYREG_PRT1_PRT
D0__PRTDSI__CAPS_SEL EQU CYREG_PRT1_CAPS_SEL
D0__PRTDSI__DBL_SYNC_IN EQU CYREG_PRT1_DBL_SYNC_IN
D0__PRTDSI__OE_SEL0 EQU CYREG_PRT1_OE_SEL0
D0__PRTDSI__OE_SEL1 EQU CYREG_PRT1_OE_SEL1
D0__PRTDSI__OUT_SEL0 EQU CYREG_PRT1_OUT_SEL0
D0__PRTDSI__OUT_SEL1 EQU CYREG_PRT1_OUT_SEL1
D0__PRTDSI__SYNC_OUT EQU CYREG_PRT1_SYNC_OUT
D0__PS EQU CYREG_PRT1_PS
D0__SHIFT EQU 2
D0__SLW EQU CYREG_PRT1_SLW

; D1
D1__0__INTTYPE EQU CYREG_PICU1_INTTYPE4
D1__0__MASK EQU 0x10
D1__0__PC EQU CYREG_PRT1_PC4
D1__0__PORT EQU 1
D1__0__SHIFT EQU 4
D1__AG EQU CYREG_PRT1_AG
D1__AMUX EQU CYREG_PRT1_AMUX
D1__BIE EQU CYREG_PRT1_BIE
D1__BIT_MASK EQU CYREG_PRT1_BIT_MASK
D1__BYP EQU CYREG_PRT1_BYP
D1__CTL EQU CYREG_PRT1_CTL
D1__DM0 EQU CYREG_PRT1_DM0
D1__DM1 EQU CYREG_PRT1_DM1
D1__DM2 EQU CYREG_PRT1_DM2
D1__DR EQU CYREG_PRT1_DR
D1__INP_DIS EQU CYREG_PRT1_INP_DIS
D1__INTTYPE_BASE EQU CYDEV_PICU_INTTYPE_PICU1_BASE
D1__LCD_COM_SEG EQU CYREG_PRT1_LCD_COM_SEG
D1__LCD_EN EQU CYREG_PRT1_LCD_EN
D1__MASK EQU 0x10
D1__PORT EQU 1
D1__PRT EQU CYREG_PRT1_PRT
D1__PRTDSI__CAPS_SEL EQU CYREG_PRT1_CAPS_SEL
D1__PRTDSI__DBL_SYNC_IN EQU CYREG_PRT1_DBL_SYNC_IN
D1__PRTDSI__OE_SEL0 EQU CYREG_PRT1_OE_SEL0
D1__PRTDSI__OE_SEL1 EQU CYREG_PRT1_OE_SEL1
D1__PRTDSI__OUT_SEL0 EQU CYREG_PRT1_OUT_SEL0
D1__PRTDSI__OUT_SEL1 EQU CYREG_PRT1_OUT_SEL1
D1__PRTDSI__SYNC_OUT EQU CYREG_PRT1_SYNC_OUT
D1__PS EQU CYREG_PRT1_PS
D1__SHIFT EQU 4
D1__SLW EQU CYREG_PRT1_SLW

; D2
D2__0__INTTYPE EQU CYREG_PICU1_INTTYPE5
D2__0__MASK EQU 0x20
D2__0__PC EQU CYREG_PRT1_PC5
D2__0__PORT EQU 1
D2__0__SHIFT EQU 5
D2__AG EQU CYREG_PRT1_AG
D2__AMUX EQU CYREG_PRT1_AMUX
D2__BIE EQU CYREG_PRT1_BIE
D2__BIT_MASK EQU CYREG_PRT1_BIT_MASK
D2__BYP EQU CYREG_PRT1_BYP
D2__CTL EQU CYREG_PRT1_CTL
D2__DM0 EQU CYREG_PRT1_DM0
D2__DM1 EQU CYREG_PRT1_DM1
D2__DM2 EQU CYREG_PRT1_DM2
D2__DR EQU CYREG_PRT1_DR
D2__INP_DIS EQU CYREG_PRT1_INP_DIS
D2__INTTYPE_BASE EQU CYDEV_PICU_INTTYPE_PICU1_BASE
D2__LCD_COM_SEG EQU CYREG_PRT1_LCD_COM_SEG
D2__LCD_EN EQU CYREG_PRT1_LCD_EN
D2__MASK EQU 0x20
D2__PORT EQU 1
D2__PRT EQU CYREG_PRT1_PRT
D2__PRTDSI__CAPS_SEL EQU CYREG_PRT1_CAPS_SEL
D2__PRTDSI__DBL_SYNC_IN EQU CYREG_PRT1_DBL_SYNC_IN
D2__PRTDSI__OE_SEL0 EQU CYREG_PRT1_OE_SEL0
D2__PRTDSI__OE_SEL1 EQU CYREG_PRT1_OE_SEL1
D2__PRTDSI__OUT_SEL0 EQU CYREG_PRT1_OUT_SEL0
D2__PRTDSI__OUT_SEL1 EQU CYREG_PRT1_OUT_SEL1
D2__PRTDSI__SYNC_OUT EQU CYREG_PRT1_SYNC_OUT
D2__PS EQU CYREG_PRT1_PS
D2__SHIFT EQU 5
D2__SLW EQU CYREG_PRT1_SLW

; ADC
ADC_DEC__COHER EQU CYREG_DEC_COHER
ADC_DEC__CR EQU CYREG_DEC_CR
ADC_DEC__DR1 EQU CYREG_DEC_DR1
ADC_DEC__DR2 EQU CYREG_DEC_DR2
ADC_DEC__DR2H EQU CYREG_DEC_DR2H
ADC_DEC__GCOR EQU CYREG_DEC_GCOR
ADC_DEC__GCORH EQU CYREG_DEC_GCORH
ADC_DEC__GVAL EQU CYREG_DEC_GVAL
ADC_DEC__OCOR EQU CYREG_DEC_OCOR
ADC_DEC__OCORH EQU CYREG_DEC_OCORH
ADC_DEC__OCORM EQU CYREG_DEC_OCORM
ADC_DEC__OUTSAMP EQU CYREG_DEC_OUTSAMP
ADC_DEC__OUTSAMPH EQU CYREG_DEC_OUTSAMPH
ADC_DEC__OUTSAMPM EQU CYREG_DEC_OUTSAMPM
ADC_DEC__OUTSAMPS EQU CYREG_DEC_OUTSAMPS
ADC_DEC__PM_ACT_CFG EQU CYREG_PM_ACT_CFG10
ADC_DEC__PM_ACT_MSK EQU 0x01
ADC_DEC__PM_STBY_CFG EQU CYREG_PM_STBY_CFG10
ADC_DEC__PM_STBY_MSK EQU 0x01
ADC_DEC__SHIFT1 EQU CYREG_DEC_SHIFT1
ADC_DEC__SHIFT2 EQU CYREG_DEC_SHIFT2
ADC_DEC__SR EQU CYREG_DEC_SR
ADC_DEC__TRIM__M1 EQU CYREG_FLSHID_CUST_TABLES_DEC_M1
ADC_DEC__TRIM__M2 EQU CYREG_FLSHID_CUST_TABLES_DEC_M2
ADC_DEC__TRIM__M3 EQU CYREG_FLSHID_CUST_TABLES_DEC_M3
ADC_DEC__TRIM__M4 EQU CYREG_FLSHID_CUST_TABLES_DEC_M4
ADC_DEC__TRIM__M5 EQU CYREG_FLSHID_CUST_TABLES_DEC_M5
ADC_DEC__TRIM__M6 EQU CYREG_FLSHID_CUST_TABLES_DEC_M6
ADC_DEC__TRIM__M7 EQU CYREG_FLSHID_CUST_TABLES_DEC_M7
ADC_DEC__TRIM__M8 EQU CYREG_FLSHID_CUST_TABLES_DEC_M8
ADC_DSM__BUF0 EQU CYREG_DSM0_BUF0
ADC_DSM__BUF1 EQU CYREG_DSM0_BUF1
ADC_DSM__BUF2 EQU CYREG_DSM0_BUF2
ADC_DSM__BUF3 EQU CYREG_DSM0_BUF3
ADC_DSM__CLK EQU CYREG_DSM0_CLK
ADC_DSM__CR0 EQU CYREG_DSM0_CR0
ADC_DSM__CR1 EQU CYREG_DSM0_CR1
ADC_DSM__CR10 EQU CYREG_DSM0_CR10
ADC_DSM__CR11 EQU CYREG_DSM0_CR11
ADC_DSM__CR12 EQU CYREG_DSM0_CR12
ADC_DSM__CR13 EQU CYREG_DSM0_CR13
ADC_DSM__CR14 EQU CYREG_DSM0_CR14
ADC_DSM__CR15 EQU CYREG_DSM0_CR15
ADC_DSM__CR16 EQU CYREG_DSM0_CR16
ADC_DSM__CR17 EQU CYREG_DSM0_CR17
ADC_DSM__CR2 EQU CYREG_DSM0_CR2
ADC_DSM__CR3 EQU CYREG_DSM0_CR3
ADC_DSM__CR4 EQU CYREG_DSM0_CR4
ADC_DSM__CR5 EQU CYREG_DSM0_CR5
ADC_DSM__CR6 EQU CYREG_DSM0_CR6
ADC_DSM__CR7 EQU CYREG_DSM0_CR7
ADC_DSM__CR8 EQU CYREG_DSM0_CR8
ADC_DSM__CR9 EQU CYREG_DSM0_CR9
ADC_DSM__DEM0 EQU CYREG_DSM0_DEM0
ADC_DSM__DEM1 EQU CYREG_DSM0_DEM1
ADC_DSM__MISC EQU CYREG_DSM0_MISC
ADC_DSM__OUT0 EQU CYREG_DSM0_OUT0
ADC_DSM__OUT1 EQU CYREG_DSM0_OUT1
ADC_DSM__REF0 EQU CYREG_DSM0_REF0
ADC_DSM__REF1 EQU CYREG_DSM0_REF1
ADC_DSM__REF2 EQU CYREG_DSM0_REF2
ADC_DSM__REF3 EQU CYREG_DSM0_REF3
ADC_DSM__RSVD1 EQU CYREG_DSM0_RSVD1
ADC_DSM__SW0 EQU CYREG_DSM0_SW0
ADC_DSM__SW2 EQU CYREG_DSM0_SW2
ADC_DSM__SW3 EQU CYREG_DSM0_SW3
ADC_DSM__SW4 EQU CYREG_DSM0_SW4
ADC_DSM__SW6 EQU CYREG_DSM0_SW6
ADC_DSM__TR0 EQU CYREG_NPUMP_DSM_TR0
ADC_DSM__TST0 EQU CYREG_DSM0_TST0
ADC_DSM__TST1 EQU CYREG_DSM0_TST1
ADC_Ext_CP_Clk__CFG0 EQU CYREG_CLKDIST_DCFG0_CFG0
ADC_Ext_CP_Clk__CFG1 EQU CYREG_CLKDIST_DCFG0_CFG1
ADC_Ext_CP_Clk__CFG2 EQU CYREG_CLKDIST_DCFG0_CFG2
ADC_Ext_CP_Clk__CFG2_SRC_SEL_MASK EQU 0x07
ADC_Ext_CP_Clk__INDEX EQU 0x00
ADC_Ext_CP_Clk__PM_ACT_CFG EQU CYREG_PM_ACT_CFG2
ADC_Ext_CP_Clk__PM_ACT_MSK EQU 0x01
ADC_Ext_CP_Clk__PM_STBY_CFG EQU CYREG_PM_STBY_CFG2
ADC_Ext_CP_Clk__PM_STBY_MSK EQU 0x01
ADC_IRQ__INTC_CLR_EN_REG EQU CYREG_NVIC_CLRENA0
ADC_IRQ__INTC_CLR_PD_REG EQU CYREG_NVIC_CLRPEND0
ADC_IRQ__INTC_MASK EQU 0x20000000
ADC_IRQ__INTC_NUMBER EQU 29
ADC_IRQ__INTC_PRIOR_NUM EQU 7
ADC_IRQ__INTC_PRIOR_REG EQU CYREG_NVIC_PRI_29
ADC_IRQ__INTC_SET_EN_REG EQU CYREG_NVIC_SETENA0
ADC_IRQ__INTC_SET_PD_REG EQU CYREG_NVIC_SETPEND0
ADC_theACLK__CFG0 EQU CYREG_CLKDIST_ACFG0_CFG0
ADC_theACLK__CFG1 EQU CYREG_CLKDIST_ACFG0_CFG1
ADC_theACLK__CFG2 EQU CYREG_CLKDIST_ACFG0_CFG2
ADC_theACLK__CFG2_SRC_SEL_MASK EQU 0x07
ADC_theACLK__CFG3 EQU CYREG_CLKDIST_ACFG0_CFG3
ADC_theACLK__CFG3_PHASE_DLY_MASK EQU 0x0F
ADC_theACLK__INDEX EQU 0x00
ADC_theACLK__PM_ACT_CFG EQU CYREG_PM_ACT_CFG1
ADC_theACLK__PM_ACT_MSK EQU 0x01
ADC_theACLK__PM_STBY_CFG EQU CYREG_PM_STBY_CFG1
ADC_theACLK__PM_STBY_MSK EQU 0x01

; PGA
PGA_SC__BST EQU CYREG_SC0_BST
PGA_SC__CLK EQU CYREG_SC0_CLK
PGA_SC__CMPINV EQU CYREG_SC_CMPINV
PGA_SC__CMPINV_MASK EQU 0x01
PGA_SC__CPTR EQU CYREG_SC_CPTR
PGA_SC__CPTR_MASK EQU 0x01
PGA_SC__CR0 EQU CYREG_SC0_CR0
PGA_SC__CR1 EQU CYREG_SC0_CR1
PGA_SC__CR2 EQU CYREG_SC0_CR2
PGA_SC__MSK EQU CYREG_SC_MSK
PGA_SC__MSK_MASK EQU 0x01
PGA_SC__PM_ACT_CFG EQU CYREG_PM_ACT_CFG9
PGA_SC__PM_ACT_MSK EQU 0x01
PGA_SC__PM_STBY_CFG EQU CYREG_PM_STBY_CFG9
PGA_SC__PM_STBY_MSK EQU 0x01
PGA_SC__SR EQU CYREG_SC_SR
PGA_SC__SR_MASK EQU 0x01
PGA_SC__SW0 EQU CYREG_SC0_SW0
PGA_SC__SW10 EQU CYREG_SC0_SW10
PGA_SC__SW2 EQU CYREG_SC0_SW2
PGA_SC__SW3 EQU CYREG_SC0_SW3
PGA_SC__SW4 EQU CYREG_SC0_SW4
PGA_SC__SW6 EQU CYREG_SC0_SW6
PGA_SC__SW7 EQU CYREG_SC0_SW7
PGA_SC__SW8 EQU CYREG_SC0_SW8
PGA_SC__WRK1 EQU CYREG_SC_WRK1
PGA_SC__WRK1_MASK EQU 0x01

; Rx_1
Rx_1__0__INTTYPE EQU CYREG_PICU12_INTTYPE6
Rx_1__0__MASK EQU 0x40
Rx_1__0__PC EQU CYREG_PRT12_PC6
Rx_1__0__PORT EQU 12
Rx_1__0__SHIFT EQU 6
Rx_1__AG EQU CYREG_PRT12_AG
Rx_1__BIE EQU CYREG_PRT12_BIE
Rx_1__BIT_MASK EQU CYREG_PRT12_BIT_MASK
Rx_1__BYP EQU CYREG_PRT12_BYP
Rx_1__DM0 EQU CYREG_PRT12_DM0
Rx_1__DM1 EQU CYREG_PRT12_DM1
Rx_1__DM2 EQU CYREG_PRT12_DM2
Rx_1__DR EQU CYREG_PRT12_DR
Rx_1__INP_DIS EQU CYREG_PRT12_INP_DIS
Rx_1__INTTYPE_BASE EQU CYDEV_PICU_INTTYPE_PICU12_BASE
Rx_1__MASK EQU 0x40
Rx_1__PORT EQU 12
Rx_1__PRT EQU CYREG_PRT12_PRT
Rx_1__PRTDSI__DBL_SYNC_IN EQU CYREG_PRT12_DBL_SYNC_IN
Rx_1__PRTDSI__OE_SEL0 EQU CYREG_PRT12_OE_SEL0
Rx_1__PRTDSI__OE_SEL1 EQU CYREG_PRT12_OE_SEL1
Rx_1__PRTDSI__OUT_SEL0 EQU CYREG_PRT12_OUT_SEL0
Rx_1__PRTDSI__OUT_SEL1 EQU CYREG_PRT12_OUT_SEL1
Rx_1__PRTDSI__SYNC_OUT EQU CYREG_PRT12_SYNC_OUT
Rx_1__PS EQU CYREG_PRT12_PS
Rx_1__SHIFT EQU 6
Rx_1__SIO_CFG EQU CYREG_PRT12_SIO_CFG
Rx_1__SIO_DIFF EQU CYREG_PRT12_SIO_DIFF
Rx_1__SIO_HYST_EN EQU CYREG_PRT12_SIO_HYST_EN
Rx_1__SIO_REG_HIFREQ EQU CYREG_PRT12_SIO_REG_HIFREQ
Rx_1__SLW EQU CYREG_PRT12_SLW

; Tx_1
Tx_1__0__INTTYPE EQU CYREG_PICU12_INTTYPE7
Tx_1__0__MASK EQU 0x80
Tx_1__0__PC EQU CYREG_PRT12_PC7
Tx_1__0__PORT EQU 12
Tx_1__0__SHIFT EQU 7
Tx_1__AG EQU CYREG_PRT12_AG
Tx_1__BIE EQU CYREG_PRT12_BIE
Tx_1__BIT_MASK EQU CYREG_PRT12_BIT_MASK
Tx_1__BYP EQU CYREG_PRT12_BYP
Tx_1__DM0 EQU CYREG_PRT12_DM0
Tx_1__DM1 EQU CYREG_PRT12_DM1
Tx_1__DM2 EQU CYREG_PRT12_DM2
Tx_1__DR EQU CYREG_PRT12_DR
Tx_1__INP_DIS EQU CYREG_PRT12_INP_DIS
Tx_1__INTTYPE_BASE EQU CYDEV_PICU_INTTYPE_PICU12_BASE
Tx_1__MASK EQU 0x80
Tx_1__PORT EQU 12
Tx_1__PRT EQU CYREG_PRT12_PRT
Tx_1__PRTDSI__DBL_SYNC_IN EQU CYREG_PRT12_DBL_SYNC_IN
Tx_1__PRTDSI__OE_SEL0 EQU CYREG_PRT12_OE_SEL0
Tx_1__PRTDSI__OE_SEL1 EQU CYREG_PRT12_OE_SEL1
Tx_1__PRTDSI__OUT_SEL0 EQU CYREG_PRT12_OUT_SEL0
Tx_1__PRTDSI__OUT_SEL1 EQU CYREG_PRT12_OUT_SEL1
Tx_1__PRTDSI__SYNC_OUT EQU CYREG_PRT12_SYNC_OUT
Tx_1__PS EQU CYREG_PRT12_PS
Tx_1__SHIFT EQU 7
Tx_1__SIO_CFG EQU CYREG_PRT12_SIO_CFG
Tx_1__SIO_DIFF EQU CYREG_PRT12_SIO_DIFF
Tx_1__SIO_HYST_EN EQU CYREG_PRT12_SIO_HYST_EN
Tx_1__SIO_REG_HIFREQ EQU CYREG_PRT12_SIO_REG_HIFREQ
Tx_1__SLW EQU CYREG_PRT12_SLW

; UART
UART_BUART_sRX_RxBitCounter__CONTROL_AUX_CTL_REG EQU CYREG_B1_UDB11_ACTL
UART_BUART_sRX_RxBitCounter__CONTROL_REG EQU CYREG_B1_UDB11_CTL
UART_BUART_sRX_RxBitCounter__CONTROL_ST_REG EQU CYREG_B1_UDB11_ST_CTL
UART_BUART_sRX_RxBitCounter__COUNT_REG EQU CYREG_B1_UDB11_CTL
UART_BUART_sRX_RxBitCounter__COUNT_ST_REG EQU CYREG_B1_UDB11_ST_CTL
UART_BUART_sRX_RxBitCounter__MASK_CTL_AUX_CTL_REG EQU CYREG_B1_UDB11_MSK_ACTL
UART_BUART_sRX_RxBitCounter__PER_CTL_AUX_CTL_REG EQU CYREG_B1_UDB11_MSK_ACTL
UART_BUART_sRX_RxBitCounter__PERIOD_REG EQU CYREG_B1_UDB11_MSK
UART_BUART_sRX_RxBitCounter_ST__MASK_REG EQU CYREG_B1_UDB11_MSK
UART_BUART_sRX_RxBitCounter_ST__MASK_ST_AUX_CTL_REG EQU CYREG_B1_UDB11_MSK_ACTL
UART_BUART_sRX_RxBitCounter_ST__PER_ST_AUX_CTL_REG EQU CYREG_B1_UDB11_MSK_ACTL
UART_BUART_sRX_RxBitCounter_ST__STATUS_AUX_CTL_REG EQU CYREG_B1_UDB11_ACTL
UART_BUART_sRX_RxBitCounter_ST__STATUS_CNT_REG EQU CYREG_B1_UDB11_ST_CTL
UART_BUART_sRX_RxBitCounter_ST__STATUS_CONTROL_REG EQU CYREG_B1_UDB11_ST_CTL
UART_BUART_sRX_RxBitCounter_ST__STATUS_REG EQU CYREG_B1_UDB11_ST
UART_BUART_sRX_RxShifter_u0__16BIT_A0_REG EQU CYREG_B1_UDB09_10_A0
UART_BUART_sRX_RxShifter_u0__16BIT_A1_REG EQU CYREG_B1_UDB09_10_A1
UART_BUART_sRX_RxShifter_u0__16BIT_D0_REG EQU CYREG_B1_UDB09_10_D0
UART_BUART_sRX_RxShifter_u0__16BIT_D1_REG EQU CYREG_B1_UDB09_10_D1
UART_BUART_sRX_RxShifter_u0__16BIT_DP_AUX_CTL_REG EQU CYREG_B1_UDB09_10_ACTL
UART_BUART_sRX_RxShifter_u0__16BIT_F0_REG EQU CYREG_B1_UDB09_10_F0
UART_BUART_sRX_RxShifter_u0__16BIT_F1_REG EQU CYREG_B1_UDB09_10_F1
UART_BUART_sRX_RxShifter_u0__A0_A1_REG EQU CYREG_B1_UDB09_A0_A1
UART_BUART_sRX_RxShifter_u0__A0_REG EQU CYREG_B1_UDB09_A0
UART_BUART_sRX_RxShifter_u0__A1_REG EQU CYREG_B1_UDB09_A1
UART_BUART_sRX_RxShifter_u0__D0_D1_REG EQU CYREG_B1_UDB09_D0_D1
UART_BUART_sRX_RxShifter_u0__D0_REG EQU CYREG_B1_UDB09_D0
UART_BUART_sRX_RxShifter_u0__D1_REG EQU CYREG_B1_UDB09_D1
UART_BUART_sRX_RxShifter_u0__DP_AUX_CTL_REG EQU CYREG_B1_UDB09_ACTL
UART_BUART_sRX_RxShifter_u0__F0_F1_REG EQU CYREG_B1_UDB09_F0_F1
UART_BUART_sRX_RxShifter_u0__F0_REG EQU CYREG_B1_UDB09_F0
UART_BUART_sRX_RxShifter_u0__F1_REG EQU CYREG_B1_UDB09_F1
UART_BUART_sRX_RxSts__16BIT_STATUS_AUX_CTL_REG EQU CYREG_B1_UDB09_10_ACTL
UART_BUART_sRX_RxSts__16BIT_STATUS_REG EQU CYREG_B1_UDB09_10_ST
UART_BUART_sRX_RxSts__3__MASK EQU 0x08
UART_BUART_sRX_RxSts__3__POS EQU 3
UART_BUART_sRX_RxSts__4__MASK EQU 0x10
UART_BUART_sRX_RxSts__4__POS EQU 4
UART_BUART_sRX_RxSts__5__MASK EQU 0x20
UART_BUART_sRX_RxSts__5__POS EQU 5
UART_BUART_sRX_RxSts__MASK EQU 0x38
UART_BUART_sRX_RxSts__MASK_REG EQU CYREG_B1_UDB09_MSK
UART_BUART_sRX_RxSts__STATUS_AUX_CTL_REG EQU CYREG_B1_UDB09_ACTL
UART_BUART_sRX_RxSts__STATUS_REG EQU CYREG_B1_UDB09_ST
UART_BUART_sTX_sCLOCK_TxBitClkGen__16BIT_A0_REG EQU CYREG_B0_UDB09_10_A0
UART_BUART_sTX_sCLOCK_TxBitClkGen__16BIT_A1_REG EQU CYREG_B0_UDB09_10_A1
UART_BUART_sTX_sCLOCK_TxBitClkGen__16BIT_D0_REG EQU CYREG_B0_UDB09_10_D0
UART_BUART_sTX_sCLOCK_TxBitClkGen__16BIT_D1_REG EQU CYREG_B0_UDB09_10_D1
UART_BUART_sTX_sCLOCK_TxBitClkGen__16BIT_DP_AUX_CTL_REG EQU CYREG_B0_UDB09_10_ACTL
UART_BUART_sTX_sCLOCK_TxBitClkGen__16BIT_F0_REG EQU CYREG_B0_UDB09_10_F0
UART_BUART_sTX_sCLOCK_TxBitClkGen__16BIT_F1_REG EQU CYREG_B0_UDB09_10_F1
UART_BUART_sTX_sCLOCK_TxBitClkGen__A0_A1_REG EQU CYREG_B0_UDB09_A0_A1
UART_BUART_sTX_sCLOCK_TxBitClkGen__A0_REG EQU CYREG_B0_UDB09_A0
UART_BUART_sTX_sCLOCK_TxBitClkGen__A1_REG EQU CYREG_B0_UDB09_A1
UART_BUART_sTX_sCLOCK_TxBitClkGen__D0_D1_REG EQU CYREG_B0_UDB09_D0_D1
UART_BUART_sTX_sCLOCK_TxBitClkGen__D0_REG EQU CYREG_B0_UDB09_D0
UART_BUART_sTX_sCLOCK_TxBitClkGen__D1_REG EQU CYREG_B0_UDB09_D1
UART_BUART_sTX_sCLOCK_TxBitClkGen__DP_AUX_CTL_REG EQU CYREG_B0_UDB09_ACTL
UART_BUART_sTX_sCLOCK_TxBitClkGen__F0_F1_REG EQU CYREG_B0_UDB09_F0_F1
UART_BUART_sTX_sCLOCK_TxBitClkGen__F0_REG EQU CYREG_B0_UDB09_F0
UART_BUART_sTX_sCLOCK_TxBitClkGen__F1_REG EQU CYREG_B0_UDB09_F1
UART_BUART_sTX_TxShifter_u0__16BIT_A0_REG EQU CYREG_B0_UDB08_09_A0
UART_BUART_sTX_TxShifter_u0__16BIT_A1_REG EQU CYREG_B0_UDB08_09_A1
UART_BUART_sTX_TxShifter_u0__16BIT_D0_REG EQU CYREG_B0_UDB08_09_D0
UART_BUART_sTX_TxShifter_u0__16BIT_D1_REG EQU CYREG_B0_UDB08_09_D1
UART_BUART_sTX_TxShifter_u0__16BIT_DP_AUX_CTL_REG EQU CYREG_B0_UDB08_09_ACTL
UART_BUART_sTX_TxShifter_u0__16BIT_F0_REG EQU CYREG_B0_UDB08_09_F0
UART_BUART_sTX_TxShifter_u0__16BIT_F1_REG EQU CYREG_B0_UDB08_09_F1
UART_BUART_sTX_TxShifter_u0__A0_A1_REG EQU CYREG_B0_UDB08_A0_A1
UART_BUART_sTX_TxShifter_u0__A0_REG EQU CYREG_B0_UDB08_A0
UART_BUART_sTX_TxShifter_u0__A1_REG EQU CYREG_B0_UDB08_A1
UART_BUART_sTX_TxShifter_u0__D0_D1_REG EQU CYREG_B0_UDB08_D0_D1
UART_BUART_sTX_TxShifter_u0__D0_REG EQU CYREG_B0_UDB08_D0
UART_BUART_sTX_TxShifter_u0__D1_REG EQU CYREG_B0_UDB08_D1
UART_BUART_sTX_TxShifter_u0__DP_AUX_CTL_REG EQU CYREG_B0_UDB08_ACTL
UART_BUART_sTX_TxShifter_u0__F0_F1_REG EQU CYREG_B0_UDB08_F0_F1
UART_BUART_sTX_TxShifter_u0__F0_REG EQU CYREG_B0_UDB08_F0
UART_BUART_sTX_TxShifter_u0__F1_REG EQU CYREG_B0_UDB08_F1
UART_BUART_sTX_TxSts__0__MASK EQU 0x01
UART_BUART_sTX_TxSts__0__POS EQU 0
UART_BUART_sTX_TxSts__1__MASK EQU 0x02
UART_BUART_sTX_TxSts__1__POS EQU 1
UART_BUART_sTX_TxSts__16BIT_STATUS_AUX_CTL_REG EQU CYREG_B0_UDB08_09_ACTL
UART_BUART_sTX_TxSts__16BIT_STATUS_REG EQU CYREG_B0_UDB08_09_ST
UART_BUART_sTX_TxSts__2__MASK EQU 0x04
UART_BUART_sTX_TxSts__2__POS EQU 2
UART_BUART_sTX_TxSts__3__MASK EQU 0x08
UART_BUART_sTX_TxSts__3__POS EQU 3
UART_BUART_sTX_TxSts__MASK EQU 0x0F
UART_BUART_sTX_TxSts__MASK_REG EQU CYREG_B0_UDB08_MSK
UART_BUART_sTX_TxSts__STATUS_AUX_CTL_REG EQU CYREG_B0_UDB08_ACTL
UART_BUART_sTX_TxSts__STATUS_REG EQU CYREG_B0_UDB08_ST
UART_IntClock__CFG0 EQU CYREG_CLKDIST_DCFG1_CFG0
UART_IntClock__CFG1 EQU CYREG_CLKDIST_DCFG1_CFG1
UART_IntClock__CFG2 EQU CYREG_CLKDIST_DCFG1_CFG2
UART_IntClock__CFG2_SRC_SEL_MASK EQU 0x07
UART_IntClock__INDEX EQU 0x01
UART_IntClock__PM_ACT_CFG EQU CYREG_PM_ACT_CFG2
UART_IntClock__PM_ACT_MSK EQU 0x02
UART_IntClock__PM_STBY_CFG EQU CYREG_PM_STBY_CFG2
UART_IntClock__PM_STBY_MSK EQU 0x02
UART_RXInternalInterrupt__INTC_CLR_EN_REG EQU CYREG_NVIC_CLRENA0
UART_RXInternalInterrupt__INTC_CLR_PD_REG EQU CYREG_NVIC_CLRPEND0
UART_RXInternalInterrupt__INTC_MASK EQU 0x01
UART_RXInternalInterrupt__INTC_NUMBER EQU 0
UART_RXInternalInterrupt__INTC_PRIOR_NUM EQU 7
UART_RXInternalInterrupt__INTC_PRIOR_REG EQU CYREG_NVIC_PRI_0
UART_RXInternalInterrupt__INTC_SET_EN_REG EQU CYREG_NVIC_SETENA0
UART_RXInternalInterrupt__INTC_SET_PD_REG EQU CYREG_NVIC_SETPEND0
UART_TXInternalInterrupt__INTC_CLR_EN_REG EQU CYREG_NVIC_CLRENA0
UART_TXInternalInterrupt__INTC_CLR_PD_REG EQU CYREG_NVIC_CLRPEND0
UART_TXInternalInterrupt__INTC_MASK EQU 0x02
UART_TXInternalInterrupt__INTC_NUMBER EQU 1
UART_TXInternalInterrupt__INTC_PRIOR_NUM EQU 7
UART_TXInternalInterrupt__INTC_PRIOR_REG EQU CYREG_NVIC_PRI_1
UART_TXInternalInterrupt__INTC_SET_EN_REG EQU CYREG_NVIC_SETENA0
UART_TXInternalInterrupt__INTC_SET_PD_REG EQU CYREG_NVIC_SETPEND0

; Miscellaneous
BCLK__BUS_CLK__HZ EQU 24000000
BCLK__BUS_CLK__KHZ EQU 24000
BCLK__BUS_CLK__MHZ EQU 24
CYDEV_CHIP_DIE_LEOPARD EQU 1
CYDEV_CHIP_DIE_PSOC4A EQU 18
CYDEV_CHIP_DIE_PSOC5LP EQU 2
CYDEV_CHIP_DIE_PSOC5TM EQU 3
CYDEV_CHIP_DIE_TMA4 EQU 4
CYDEV_CHIP_DIE_UNKNOWN EQU 0
CYDEV_CHIP_FAMILY_FM0P EQU 5
CYDEV_CHIP_FAMILY_FM3 EQU 6
CYDEV_CHIP_FAMILY_FM4 EQU 7
CYDEV_CHIP_FAMILY_PSOC3 EQU 1
CYDEV_CHIP_FAMILY_PSOC4 EQU 2
CYDEV_CHIP_FAMILY_PSOC5 EQU 3
CYDEV_CHIP_FAMILY_PSOC6 EQU 4
CYDEV_CHIP_FAMILY_UNKNOWN EQU 0
CYDEV_CHIP_FAMILY_USED EQU CYDEV_CHIP_FAMILY_PSOC5
CYDEV_CHIP_JTAG_ID EQU 0x2E161069
CYDEV_CHIP_MEMBER_3A EQU 1
CYDEV_CHIP_MEMBER_4A EQU 18
CYDEV_CHIP_MEMBER_4D EQU 13
CYDEV_CHIP_MEMBER_4E EQU 6
CYDEV_CHIP_MEMBER_4F EQU 19
CYDEV_CHIP_MEMBER_4G EQU 4
CYDEV_CHIP_MEMBER_4H EQU 17
CYDEV_CHIP_MEMBER_4I EQU 23
CYDEV_CHIP_MEMBER_4J EQU 14
CYDEV_CHIP_MEMBER_4K EQU 15
CYDEV_CHIP_MEMBER_4L EQU 22
CYDEV_CHIP_MEMBER_4M EQU 21
CYDEV_CHIP_MEMBER_4N EQU 10
CYDEV_CHIP_MEMBER_4O EQU 7
CYDEV_CHIP_MEMBER_4P EQU 20
CYDEV_CHIP_MEMBER_4Q EQU 12
CYDEV_CHIP_MEMBER_4R EQU 8
CYDEV_CHIP_MEMBER_4S EQU 11
CYDEV_CHIP_MEMBER_4T EQU 9
CYDEV_CHIP_MEMBER_4U EQU 5
CYDEV_CHIP_MEMBER_4V EQU 16
CYDEV_CHIP_MEMBER_5A EQU 3
CYDEV_CHIP_MEMBER_5B EQU 2
CYDEV_CHIP_MEMBER_6A EQU 24
CYDEV_CHIP_MEMBER_FM3 EQU 28
CYDEV_CHIP_MEMBER_FM4 EQU 29
CYDEV_CHIP_MEMBER_PDL_FM0P_TYPE1 EQU 25
CYDEV_CHIP_MEMBER_PDL_FM0P_TYPE2 EQU 26
CYDEV_CHIP_MEMBER_PDL_FM0P_TYPE3 EQU 27
CYDEV_CHIP_MEMBER_UNKNOWN EQU 0
CYDEV_CHIP_MEMBER_USED EQU CYDEV_CHIP_MEMBER_5B
CYDEV_CHIP_DIE_EXPECT EQU CYDEV_CHIP_MEMBER_USED
CYDEV_CHIP_DIE_ACTUAL EQU CYDEV_CHIP_DIE_EXPECT
CYDEV_CHIP_REV_LEOPARD_ES1 EQU 0
CYDEV_CHIP_REV_LEOPARD_ES2 EQU 1
CYDEV_CHIP_REV_LEOPARD_ES3 EQU 3
CYDEV_CHIP_REV_LEOPARD_PRODUCTION EQU 3
CYDEV_CHIP_REV_PSOC4A_ES0 EQU 17
CYDEV_CHIP_REV_PSOC4A_PRODUCTION EQU 17
CYDEV_CHIP_REV_PSOC5LP_ES0 EQU 0
CYDEV_CHIP_REV_PSOC5LP_PRODUCTION EQU 0
CYDEV_CHIP_REV_PSOC5TM_ES0 EQU 0
CYDEV_CHIP_REV_PSOC5TM_ES1 EQU 1
CYDEV_CHIP_REV_PSOC5TM_PRODUCTION EQU 1
CYDEV_CHIP_REV_TMA4_ES EQU 17
CYDEV_CHIP_REV_TMA4_ES2 EQU 33
CYDEV_CHIP_REV_TMA4_PRODUCTION EQU 17
CYDEV_CHIP_REVISION_3A_ES1 EQU 0
CYDEV_CHIP_REVISION_3A_ES2 EQU 1
CYDEV_CHIP_REVISION_3A_ES3 EQU 3
CYDEV_CHIP_REVISION_3A_PRODUCTION EQU 3
CYDEV_CHIP_REVISION_4A_ES0 EQU 17
CYDEV_CHIP_REVISION_4A_PRODUCTION EQU 17
CYDEV_CHIP_REVISION_4D_PRODUCTION EQU 0
CYDEV_CHIP_REVISION_4E_CCG2_NO_USBPD EQU 0
CYDEV_CHIP_REVISION_4E_PRODUCTION EQU 0
CYDEV_CHIP_REVISION_4F_PRODUCTION EQU 0
CYDEV_CHIP_REVISION_4F_PRODUCTION_256DMA EQU 0
CYDEV_CHIP_REVISION_4F_PRODUCTION_256K EQU 0
CYDEV_CHIP_REVISION_4G_ES EQU 17
CYDEV_CHIP_REVISION_4G_ES2 EQU 33
CYDEV_CHIP_REVISION_4G_PRODUCTION EQU 17
CYDEV_CHIP_REVISION_4H_PRODUCTION EQU 0
CYDEV_CHIP_REVISION_4I_PRODUCTION EQU 0
CYDEV_CHIP_REVISION_4J_PRODUCTION EQU 0
CYDEV_CHIP_REVISION_4K_PRODUCTION EQU 0
CYDEV_CHIP_REVISION_4L_PRODUCTION EQU 0
CYDEV_CHIP_REVISION_4M_PRODUCTION EQU 0
CYDEV_CHIP_REVISION_4N_PRODUCTION EQU 0
CYDEV_CHIP_REVISION_4O_PRODUCTION EQU 0
CYDEV_CHIP_REVISION_4P_PRODUCTION EQU 0
CYDEV_CHIP_REVISION_4Q_PRODUCTION EQU 0
CYDEV_CHIP_REVISION_4R_PRODUCTION EQU 0
CYDEV_CHIP_REVISION_4S_PRODUCTION EQU 0
CYDEV_CHIP_REVISION_4T_PRODUCTION EQU 0
CYDEV_CHIP_REVISION_4U_PRODUCTION EQU 0
CYDEV_CHIP_REVISION_4V_PRODUCTION EQU 0
CYDEV_CHIP_REVISION_5A_ES0 EQU 0
CYDEV_CHIP_REVISION_5A_ES1 EQU 1
CYDEV_CHIP_REVISION_5A_PRODUCTION EQU 1
CYDEV_CHIP_REVISION_5B_ES0 EQU 0
CYDEV_CHIP_REVISION_5B_PRODUCTION EQU 0
CYDEV_CHIP_REVISION_6A_ES EQU 17
CYDEV_CHIP_REVISION_6A_NO_UDB EQU 33
CYDEV_CHIP_REVISION_6A_PRODUCTION EQU 33
CYDEV_CHIP_REVISION_FM3_PRODUCTION EQU 0
CYDEV_CHIP_REVISION_FM4_PRODUCTION EQU 0
CYDEV_CHIP_REVISION_PDL_FM0P_TYPE1_PRODUCTION EQU 0
CYDEV_CHIP_REVISION_PDL_FM0P_TYPE2_PRODUCTION EQU 0
CYDEV_CHIP_REVISION_PDL_FM0P_TYPE3_PRODUCTION EQU 0
CYDEV_CHIP_REVISION_USED EQU CYDEV_CHIP_REVISION_5B_PRODUCTION
CYDEV_CHIP_REV_EXPECT EQU CYDEV_CHIP_REVISION_USED
CYDEV_CONFIG_FASTBOOT_ENABLED EQU 1
CYDEV_CONFIG_UNUSED_IO_AllowButWarn EQU 0
CYDEV_CONFIG_UNUSED_IO EQU CYDEV_CONFIG_UNUSED_IO_AllowButWarn
CYDEV_CONFIG_UNUSED_IO_AllowWithInfo EQU 1
CYDEV_CONFIG_UNUSED_IO_Disallowed EQU 2
CYDEV_CONFIGURATION_COMPRESSED EQU 1
CYDEV_CONFIGURATION_DMA EQU 0
CYDEV_CONFIGURATION_ECC EQU 1
CYDEV_CONFIGURATION_IMOENABLED EQU CYDEV_CONFIG_FASTBOOT_ENABLED
CYDEV_CONFIGURATION_MODE_COMPRESSED EQU 0
CYDEV_CONFIGURATION_MODE EQU CYDEV_CONFIGURATION_MODE_COMPRESSED
CYDEV_CONFIGURATION_MODE_DMA EQU 2
CYDEV_CONFIGURATION_MODE_UNCOMPRESSED EQU 1
CYDEV_DEBUG_ENABLE_MASK EQU 0x20
CYDEV_DEBUG_ENABLE_REGISTER EQU CYREG_MLOGIC_DEBUG
CYDEV_DEBUGGING_DPS_Disable EQU 3
CYDEV_DEBUGGING_DPS_JTAG_4 EQU 1
CYDEV_DEBUGGING_DPS_JTAG_5 EQU 0
CYDEV_DEBUGGING_DPS_SWD EQU 2
CYDEV_DEBUGGING_DPS_SWD_SWV EQU 6
CYDEV_DEBUGGING_DPS EQU CYDEV_DEBUGGING_DPS_SWD_SWV
CYDEV_DEBUGGING_ENABLE EQU 1
CYDEV_DEBUGGING_XRES EQU 0
CYDEV_DMA_CHANNELS_AVAILABLE EQU 24
CYDEV_ECC_ENABLE EQU 0
CYDEV_HEAP_SIZE EQU 0x200
CYDEV_INSTRUCT_CACHE_ENABLED EQU 1
CYDEV_INTR_RISING EQU 0x00000003
CYDEV_IS_EXPORTING_CODE EQU 0
CYDEV_IS_IMPORTING_CODE EQU 0
CYDEV_PROJ_TYPE EQU 0
CYDEV_PROJ_TYPE_BOOTLOADER EQU 1
CYDEV_PROJ_TYPE_LAUNCHER EQU 5
CYDEV_PROJ_TYPE_LOADABLE EQU 2
CYDEV_PROJ_TYPE_LOADABLEANDBOOTLOADER EQU 4
CYDEV_PROJ_TYPE_MULTIAPPBOOTLOADER EQU 3
CYDEV_PROJ_TYPE_STANDARD EQU 0
CYDEV_PROTECTION_ENABLE EQU 0
CYDEV_STACK_SIZE EQU 0x0800
CYDEV_USE_BUNDLED_CMSIS EQU 1
CYDEV_VARIABLE_VDDA EQU 0
CYDEV_VDDA_MV EQU 5000
CYDEV_VDDD_MV EQU 5000
CYDEV_VDDIO0_MV EQU 5000
CYDEV_VDDIO1_MV EQU 5000
CYDEV_VDDIO2_MV EQU 5000
CYDEV_VDDIO3_MV EQU 5000
CYDEV_VIO0_MV EQU 5000
CYDEV_VIO1_MV EQU 5000
CYDEV_VIO2_MV EQU 5000
CYDEV_VIO3_MV EQU 5000
CYIPBLOCK_ARM_CM3_VERSION EQU 0
CYIPBLOCK_P3_ANAIF_VERSION EQU 0
CYIPBLOCK_P3_CAN_VERSION EQU 0
CYIPBLOCK_P3_CAPSENSE_VERSION EQU 0
CYIPBLOCK_P3_COMP_VERSION EQU 0
CYIPBLOCK_P3_DECIMATOR_VERSION EQU 0
CYIPBLOCK_P3_DFB_VERSION EQU 0
CYIPBLOCK_P3_DMA_VERSION EQU 0
CYIPBLOCK_P3_DRQ_VERSION EQU 0
CYIPBLOCK_P3_DSM_VERSION EQU 0
CYIPBLOCK_P3_EMIF_VERSION EQU 0
CYIPBLOCK_P3_I2C_VERSION EQU 0
CYIPBLOCK_P3_LCD_VERSION EQU 0
CYIPBLOCK_P3_LPF_VERSION EQU 0
CYIPBLOCK_P3_OPAMP_VERSION EQU 0
CYIPBLOCK_P3_PM_VERSION EQU 0
CYIPBLOCK_P3_SCCT_VERSION EQU 0
CYIPBLOCK_P3_TIMER_VERSION EQU 0
CYIPBLOCK_P3_USB_VERSION EQU 0
CYIPBLOCK_P3_VIDAC_VERSION EQU 0
CYIPBLOCK_P3_VREF_VERSION EQU 0
CYIPBLOCK_S8_GPIO_VERSION EQU 0
CYIPBLOCK_S8_IRQ_VERSION EQU 0
CYIPBLOCK_S8_SAR_VERSION EQU 0
CYIPBLOCK_S8_SIO_VERSION EQU 0
CYIPBLOCK_S8_UDB_VERSION EQU 0
DMA_CHANNELS_USED__MASK0 EQU 0x00000000
CYDEV_BOOTLOADER_ENABLE EQU 0
    ENDIF
    END
