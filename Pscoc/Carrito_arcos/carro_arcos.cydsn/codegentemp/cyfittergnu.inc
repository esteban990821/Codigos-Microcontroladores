/*******************************************************************************
* File Name: cyfittergnu.inc
* 
* PSoC Creator  4.2
*
* Description:
* 
* This file is automatically generated by PSoC Creator.
*
********************************************************************************
* Copyright (c) 2007-2018 Cypress Semiconductor.  All rights reserved.
* You may use this file only in accordance with the license, terms, conditions, 
* disclaimers, and limitations in the end user license agreement accompanying 
* the software package with which this file was provided.
********************************************************************************/

.ifndef INCLUDED_CYFITTERGNU_INC
.set INCLUDED_CYFITTERGNU_INC, 1
.include "cydevicegnu.inc"
.include "cydevicegnu_trm.inc"

/* E1 */
.set E1__0__INTTYPE, CYREG_PICU1_INTTYPE2
.set E1__0__MASK, 0x04
.set E1__0__PC, CYREG_PRT1_PC2
.set E1__0__PORT, 1
.set E1__0__SHIFT, 2
.set E1__AG, CYREG_PRT1_AG
.set E1__AMUX, CYREG_PRT1_AMUX
.set E1__BIE, CYREG_PRT1_BIE
.set E1__BIT_MASK, CYREG_PRT1_BIT_MASK
.set E1__BYP, CYREG_PRT1_BYP
.set E1__CTL, CYREG_PRT1_CTL
.set E1__DM0, CYREG_PRT1_DM0
.set E1__DM1, CYREG_PRT1_DM1
.set E1__DM2, CYREG_PRT1_DM2
.set E1__DR, CYREG_PRT1_DR
.set E1__INP_DIS, CYREG_PRT1_INP_DIS
.set E1__INTTYPE_BASE, CYDEV_PICU_INTTYPE_PICU1_BASE
.set E1__LCD_COM_SEG, CYREG_PRT1_LCD_COM_SEG
.set E1__LCD_EN, CYREG_PRT1_LCD_EN
.set E1__MASK, 0x04
.set E1__PORT, 1
.set E1__PRT, CYREG_PRT1_PRT
.set E1__PRTDSI__CAPS_SEL, CYREG_PRT1_CAPS_SEL
.set E1__PRTDSI__DBL_SYNC_IN, CYREG_PRT1_DBL_SYNC_IN
.set E1__PRTDSI__OE_SEL0, CYREG_PRT1_OE_SEL0
.set E1__PRTDSI__OE_SEL1, CYREG_PRT1_OE_SEL1
.set E1__PRTDSI__OUT_SEL0, CYREG_PRT1_OUT_SEL0
.set E1__PRTDSI__OUT_SEL1, CYREG_PRT1_OUT_SEL1
.set E1__PRTDSI__SYNC_OUT, CYREG_PRT1_SYNC_OUT
.set E1__PS, CYREG_PRT1_PS
.set E1__SHIFT, 2
.set E1__SLW, CYREG_PRT1_SLW

/* Tx */
.set Tx__0__INTTYPE, CYREG_PICU0_INTTYPE1
.set Tx__0__MASK, 0x02
.set Tx__0__PC, CYREG_PRT0_PC1
.set Tx__0__PORT, 0
.set Tx__0__SHIFT, 1
.set Tx__AG, CYREG_PRT0_AG
.set Tx__AMUX, CYREG_PRT0_AMUX
.set Tx__BIE, CYREG_PRT0_BIE
.set Tx__BIT_MASK, CYREG_PRT0_BIT_MASK
.set Tx__BYP, CYREG_PRT0_BYP
.set Tx__CTL, CYREG_PRT0_CTL
.set Tx__DM0, CYREG_PRT0_DM0
.set Tx__DM1, CYREG_PRT0_DM1
.set Tx__DM2, CYREG_PRT0_DM2
.set Tx__DR, CYREG_PRT0_DR
.set Tx__INP_DIS, CYREG_PRT0_INP_DIS
.set Tx__INTTYPE_BASE, CYDEV_PICU_INTTYPE_PICU0_BASE
.set Tx__LCD_COM_SEG, CYREG_PRT0_LCD_COM_SEG
.set Tx__LCD_EN, CYREG_PRT0_LCD_EN
.set Tx__MASK, 0x02
.set Tx__PORT, 0
.set Tx__PRT, CYREG_PRT0_PRT
.set Tx__PRTDSI__CAPS_SEL, CYREG_PRT0_CAPS_SEL
.set Tx__PRTDSI__DBL_SYNC_IN, CYREG_PRT0_DBL_SYNC_IN
.set Tx__PRTDSI__OE_SEL0, CYREG_PRT0_OE_SEL0
.set Tx__PRTDSI__OE_SEL1, CYREG_PRT0_OE_SEL1
.set Tx__PRTDSI__OUT_SEL0, CYREG_PRT0_OUT_SEL0
.set Tx__PRTDSI__OUT_SEL1, CYREG_PRT0_OUT_SEL1
.set Tx__PRTDSI__SYNC_OUT, CYREG_PRT0_SYNC_OUT
.set Tx__PS, CYREG_PRT0_PS
.set Tx__SHIFT, 1
.set Tx__SLW, CYREG_PRT0_SLW

/* led */
.set led__0__INTTYPE, CYREG_PICU2_INTTYPE2
.set led__0__MASK, 0x04
.set led__0__PC, CYREG_PRT2_PC2
.set led__0__PORT, 2
.set led__0__SHIFT, 2
.set led__AG, CYREG_PRT2_AG
.set led__AMUX, CYREG_PRT2_AMUX
.set led__BIE, CYREG_PRT2_BIE
.set led__BIT_MASK, CYREG_PRT2_BIT_MASK
.set led__BYP, CYREG_PRT2_BYP
.set led__CTL, CYREG_PRT2_CTL
.set led__DM0, CYREG_PRT2_DM0
.set led__DM1, CYREG_PRT2_DM1
.set led__DM2, CYREG_PRT2_DM2
.set led__DR, CYREG_PRT2_DR
.set led__INP_DIS, CYREG_PRT2_INP_DIS
.set led__INTTYPE_BASE, CYDEV_PICU_INTTYPE_PICU2_BASE
.set led__LCD_COM_SEG, CYREG_PRT2_LCD_COM_SEG
.set led__LCD_EN, CYREG_PRT2_LCD_EN
.set led__MASK, 0x04
.set led__PORT, 2
.set led__PRT, CYREG_PRT2_PRT
.set led__PRTDSI__CAPS_SEL, CYREG_PRT2_CAPS_SEL
.set led__PRTDSI__DBL_SYNC_IN, CYREG_PRT2_DBL_SYNC_IN
.set led__PRTDSI__OE_SEL0, CYREG_PRT2_OE_SEL0
.set led__PRTDSI__OE_SEL1, CYREG_PRT2_OE_SEL1
.set led__PRTDSI__OUT_SEL0, CYREG_PRT2_OUT_SEL0
.set led__PRTDSI__OUT_SEL1, CYREG_PRT2_OUT_SEL1
.set led__PRTDSI__SYNC_OUT, CYREG_PRT2_SYNC_OUT
.set led__PS, CYREG_PRT2_PS
.set led__SHIFT, 2
.set led__SLW, CYREG_PRT2_SLW

/* ADC1 */
.set ADC1_ADC_SAR__CLK, CYREG_SAR0_CLK
.set ADC1_ADC_SAR__CSR0, CYREG_SAR0_CSR0
.set ADC1_ADC_SAR__CSR1, CYREG_SAR0_CSR1
.set ADC1_ADC_SAR__CSR2, CYREG_SAR0_CSR2
.set ADC1_ADC_SAR__CSR3, CYREG_SAR0_CSR3
.set ADC1_ADC_SAR__CSR4, CYREG_SAR0_CSR4
.set ADC1_ADC_SAR__CSR5, CYREG_SAR0_CSR5
.set ADC1_ADC_SAR__CSR6, CYREG_SAR0_CSR6
.set ADC1_ADC_SAR__PM_ACT_CFG, CYREG_PM_ACT_CFG11
.set ADC1_ADC_SAR__PM_ACT_MSK, 0x01
.set ADC1_ADC_SAR__PM_STBY_CFG, CYREG_PM_STBY_CFG11
.set ADC1_ADC_SAR__PM_STBY_MSK, 0x01
.set ADC1_ADC_SAR__SW0, CYREG_SAR0_SW0
.set ADC1_ADC_SAR__SW2, CYREG_SAR0_SW2
.set ADC1_ADC_SAR__SW3, CYREG_SAR0_SW3
.set ADC1_ADC_SAR__SW4, CYREG_SAR0_SW4
.set ADC1_ADC_SAR__SW6, CYREG_SAR0_SW6
.set ADC1_ADC_SAR__TR0, CYREG_SAR0_TR0
.set ADC1_ADC_SAR__WRK0, CYREG_SAR0_WRK0
.set ADC1_ADC_SAR__WRK1, CYREG_SAR0_WRK1
.set ADC1_IRQ__INTC_CLR_EN_REG, CYREG_NVIC_CLRENA0
.set ADC1_IRQ__INTC_CLR_PD_REG, CYREG_NVIC_CLRPEND0
.set ADC1_IRQ__INTC_MASK, 0x01
.set ADC1_IRQ__INTC_NUMBER, 0
.set ADC1_IRQ__INTC_PRIOR_NUM, 7
.set ADC1_IRQ__INTC_PRIOR_REG, CYREG_NVIC_PRI_0
.set ADC1_IRQ__INTC_SET_EN_REG, CYREG_NVIC_SETENA0
.set ADC1_IRQ__INTC_SET_PD_REG, CYREG_NVIC_SETPEND0
.set ADC1_theACLK__CFG0, CYREG_CLKDIST_DCFG0_CFG0
.set ADC1_theACLK__CFG1, CYREG_CLKDIST_DCFG0_CFG1
.set ADC1_theACLK__CFG2, CYREG_CLKDIST_DCFG0_CFG2
.set ADC1_theACLK__CFG2_SRC_SEL_MASK, 0x07
.set ADC1_theACLK__INDEX, 0x00
.set ADC1_theACLK__PM_ACT_CFG, CYREG_PM_ACT_CFG2
.set ADC1_theACLK__PM_ACT_MSK, 0x01
.set ADC1_theACLK__PM_STBY_CFG, CYREG_PM_STBY_CFG2
.set ADC1_theACLK__PM_STBY_MSK, 0x01

/* UART */
.set UART_BUART_sTX_sCLOCK_TxBitClkGen__16BIT_A0_REG, CYREG_B0_UDB09_10_A0
.set UART_BUART_sTX_sCLOCK_TxBitClkGen__16BIT_A1_REG, CYREG_B0_UDB09_10_A1
.set UART_BUART_sTX_sCLOCK_TxBitClkGen__16BIT_D0_REG, CYREG_B0_UDB09_10_D0
.set UART_BUART_sTX_sCLOCK_TxBitClkGen__16BIT_D1_REG, CYREG_B0_UDB09_10_D1
.set UART_BUART_sTX_sCLOCK_TxBitClkGen__16BIT_DP_AUX_CTL_REG, CYREG_B0_UDB09_10_ACTL
.set UART_BUART_sTX_sCLOCK_TxBitClkGen__16BIT_F0_REG, CYREG_B0_UDB09_10_F0
.set UART_BUART_sTX_sCLOCK_TxBitClkGen__16BIT_F1_REG, CYREG_B0_UDB09_10_F1
.set UART_BUART_sTX_sCLOCK_TxBitClkGen__A0_A1_REG, CYREG_B0_UDB09_A0_A1
.set UART_BUART_sTX_sCLOCK_TxBitClkGen__A0_REG, CYREG_B0_UDB09_A0
.set UART_BUART_sTX_sCLOCK_TxBitClkGen__A1_REG, CYREG_B0_UDB09_A1
.set UART_BUART_sTX_sCLOCK_TxBitClkGen__D0_D1_REG, CYREG_B0_UDB09_D0_D1
.set UART_BUART_sTX_sCLOCK_TxBitClkGen__D0_REG, CYREG_B0_UDB09_D0
.set UART_BUART_sTX_sCLOCK_TxBitClkGen__D1_REG, CYREG_B0_UDB09_D1
.set UART_BUART_sTX_sCLOCK_TxBitClkGen__DP_AUX_CTL_REG, CYREG_B0_UDB09_ACTL
.set UART_BUART_sTX_sCLOCK_TxBitClkGen__F0_F1_REG, CYREG_B0_UDB09_F0_F1
.set UART_BUART_sTX_sCLOCK_TxBitClkGen__F0_REG, CYREG_B0_UDB09_F0
.set UART_BUART_sTX_sCLOCK_TxBitClkGen__F1_REG, CYREG_B0_UDB09_F1
.set UART_BUART_sTX_TxShifter_u0__16BIT_A0_REG, CYREG_B0_UDB08_09_A0
.set UART_BUART_sTX_TxShifter_u0__16BIT_A1_REG, CYREG_B0_UDB08_09_A1
.set UART_BUART_sTX_TxShifter_u0__16BIT_D0_REG, CYREG_B0_UDB08_09_D0
.set UART_BUART_sTX_TxShifter_u0__16BIT_D1_REG, CYREG_B0_UDB08_09_D1
.set UART_BUART_sTX_TxShifter_u0__16BIT_DP_AUX_CTL_REG, CYREG_B0_UDB08_09_ACTL
.set UART_BUART_sTX_TxShifter_u0__16BIT_F0_REG, CYREG_B0_UDB08_09_F0
.set UART_BUART_sTX_TxShifter_u0__16BIT_F1_REG, CYREG_B0_UDB08_09_F1
.set UART_BUART_sTX_TxShifter_u0__A0_A1_REG, CYREG_B0_UDB08_A0_A1
.set UART_BUART_sTX_TxShifter_u0__A0_REG, CYREG_B0_UDB08_A0
.set UART_BUART_sTX_TxShifter_u0__A1_REG, CYREG_B0_UDB08_A1
.set UART_BUART_sTX_TxShifter_u0__D0_D1_REG, CYREG_B0_UDB08_D0_D1
.set UART_BUART_sTX_TxShifter_u0__D0_REG, CYREG_B0_UDB08_D0
.set UART_BUART_sTX_TxShifter_u0__D1_REG, CYREG_B0_UDB08_D1
.set UART_BUART_sTX_TxShifter_u0__DP_AUX_CTL_REG, CYREG_B0_UDB08_ACTL
.set UART_BUART_sTX_TxShifter_u0__F0_F1_REG, CYREG_B0_UDB08_F0_F1
.set UART_BUART_sTX_TxShifter_u0__F0_REG, CYREG_B0_UDB08_F0
.set UART_BUART_sTX_TxShifter_u0__F1_REG, CYREG_B0_UDB08_F1
.set UART_BUART_sTX_TxShifter_u0__MSK_DP_AUX_CTL_REG, CYREG_B0_UDB08_MSK_ACTL
.set UART_BUART_sTX_TxShifter_u0__PER_DP_AUX_CTL_REG, CYREG_B0_UDB08_MSK_ACTL
.set UART_BUART_sTX_TxSts__0__MASK, 0x01
.set UART_BUART_sTX_TxSts__0__POS, 0
.set UART_BUART_sTX_TxSts__1__MASK, 0x02
.set UART_BUART_sTX_TxSts__1__POS, 1
.set UART_BUART_sTX_TxSts__16BIT_STATUS_AUX_CTL_REG, CYREG_B1_UDB08_09_ACTL
.set UART_BUART_sTX_TxSts__16BIT_STATUS_REG, CYREG_B1_UDB08_09_ST
.set UART_BUART_sTX_TxSts__2__MASK, 0x04
.set UART_BUART_sTX_TxSts__2__POS, 2
.set UART_BUART_sTX_TxSts__3__MASK, 0x08
.set UART_BUART_sTX_TxSts__3__POS, 3
.set UART_BUART_sTX_TxSts__MASK, 0x0F
.set UART_BUART_sTX_TxSts__MASK_REG, CYREG_B1_UDB08_MSK
.set UART_BUART_sTX_TxSts__STATUS_AUX_CTL_REG, CYREG_B1_UDB08_ACTL
.set UART_BUART_sTX_TxSts__STATUS_REG, CYREG_B1_UDB08_ST
.set UART_IntClock__CFG0, CYREG_CLKDIST_DCFG1_CFG0
.set UART_IntClock__CFG1, CYREG_CLKDIST_DCFG1_CFG1
.set UART_IntClock__CFG2, CYREG_CLKDIST_DCFG1_CFG2
.set UART_IntClock__CFG2_SRC_SEL_MASK, 0x07
.set UART_IntClock__INDEX, 0x01
.set UART_IntClock__PM_ACT_CFG, CYREG_PM_ACT_CFG2
.set UART_IntClock__PM_ACT_MSK, 0x02
.set UART_IntClock__PM_STBY_CFG, CYREG_PM_STBY_CFG2
.set UART_IntClock__PM_STBY_MSK, 0x02

/* PWM_1 */
.set PWM_1_PWMUDB_genblk1_ctrlreg__7__MASK, 0x80
.set PWM_1_PWMUDB_genblk1_ctrlreg__7__POS, 7
.set PWM_1_PWMUDB_genblk1_ctrlreg__CONTROL_AUX_CTL_REG, CYREG_B1_UDB11_ACTL
.set PWM_1_PWMUDB_genblk1_ctrlreg__CONTROL_REG, CYREG_B1_UDB11_CTL
.set PWM_1_PWMUDB_genblk1_ctrlreg__CONTROL_ST_REG, CYREG_B1_UDB11_ST_CTL
.set PWM_1_PWMUDB_genblk1_ctrlreg__COUNT_REG, CYREG_B1_UDB11_CTL
.set PWM_1_PWMUDB_genblk1_ctrlreg__COUNT_ST_REG, CYREG_B1_UDB11_ST_CTL
.set PWM_1_PWMUDB_genblk1_ctrlreg__MASK, 0x80
.set PWM_1_PWMUDB_genblk1_ctrlreg__MASK_CTL_AUX_CTL_REG, CYREG_B1_UDB11_MSK_ACTL
.set PWM_1_PWMUDB_genblk1_ctrlreg__PER_CTL_AUX_CTL_REG, CYREG_B1_UDB11_MSK_ACTL
.set PWM_1_PWMUDB_genblk1_ctrlreg__PERIOD_REG, CYREG_B1_UDB11_MSK
.set PWM_1_PWMUDB_genblk8_stsreg__0__MASK, 0x01
.set PWM_1_PWMUDB_genblk8_stsreg__0__POS, 0
.set PWM_1_PWMUDB_genblk8_stsreg__2__MASK, 0x04
.set PWM_1_PWMUDB_genblk8_stsreg__2__POS, 2
.set PWM_1_PWMUDB_genblk8_stsreg__3__MASK, 0x08
.set PWM_1_PWMUDB_genblk8_stsreg__3__POS, 3
.set PWM_1_PWMUDB_genblk8_stsreg__MASK, 0x0D
.set PWM_1_PWMUDB_genblk8_stsreg__MASK_REG, CYREG_B1_UDB11_MSK
.set PWM_1_PWMUDB_genblk8_stsreg__MASK_ST_AUX_CTL_REG, CYREG_B1_UDB11_MSK_ACTL
.set PWM_1_PWMUDB_genblk8_stsreg__PER_ST_AUX_CTL_REG, CYREG_B1_UDB11_MSK_ACTL
.set PWM_1_PWMUDB_genblk8_stsreg__STATUS_AUX_CTL_REG, CYREG_B1_UDB11_ACTL
.set PWM_1_PWMUDB_genblk8_stsreg__STATUS_CNT_REG, CYREG_B1_UDB11_ST_CTL
.set PWM_1_PWMUDB_genblk8_stsreg__STATUS_CONTROL_REG, CYREG_B1_UDB11_ST_CTL
.set PWM_1_PWMUDB_genblk8_stsreg__STATUS_REG, CYREG_B1_UDB11_ST
.set PWM_1_PWMUDB_sP8_pwmdp_u0__A0_A1_REG, CYREG_B1_UDB11_A0_A1
.set PWM_1_PWMUDB_sP8_pwmdp_u0__A0_REG, CYREG_B1_UDB11_A0
.set PWM_1_PWMUDB_sP8_pwmdp_u0__A1_REG, CYREG_B1_UDB11_A1
.set PWM_1_PWMUDB_sP8_pwmdp_u0__D0_D1_REG, CYREG_B1_UDB11_D0_D1
.set PWM_1_PWMUDB_sP8_pwmdp_u0__D0_REG, CYREG_B1_UDB11_D0
.set PWM_1_PWMUDB_sP8_pwmdp_u0__D1_REG, CYREG_B1_UDB11_D1
.set PWM_1_PWMUDB_sP8_pwmdp_u0__DP_AUX_CTL_REG, CYREG_B1_UDB11_ACTL
.set PWM_1_PWMUDB_sP8_pwmdp_u0__F0_F1_REG, CYREG_B1_UDB11_F0_F1
.set PWM_1_PWMUDB_sP8_pwmdp_u0__F0_REG, CYREG_B1_UDB11_F0
.set PWM_1_PWMUDB_sP8_pwmdp_u0__F1_REG, CYREG_B1_UDB11_F1
.set PWM_1_PWMUDB_sP8_pwmdp_u0__MSK_DP_AUX_CTL_REG, CYREG_B1_UDB11_MSK_ACTL
.set PWM_1_PWMUDB_sP8_pwmdp_u0__PER_DP_AUX_CTL_REG, CYREG_B1_UDB11_MSK_ACTL

/* PWM_2 */
.set PWM_2_PWMUDB_genblk1_ctrlreg__16BIT_CONTROL_AUX_CTL_REG, CYREG_B0_UDB08_09_ACTL
.set PWM_2_PWMUDB_genblk1_ctrlreg__16BIT_CONTROL_CONTROL_REG, CYREG_B0_UDB08_09_CTL
.set PWM_2_PWMUDB_genblk1_ctrlreg__16BIT_CONTROL_COUNT_REG, CYREG_B0_UDB08_09_CTL
.set PWM_2_PWMUDB_genblk1_ctrlreg__16BIT_COUNT_CONTROL_REG, CYREG_B0_UDB08_09_CTL
.set PWM_2_PWMUDB_genblk1_ctrlreg__16BIT_COUNT_COUNT_REG, CYREG_B0_UDB08_09_CTL
.set PWM_2_PWMUDB_genblk1_ctrlreg__16BIT_MASK_MASK_REG, CYREG_B0_UDB08_09_MSK
.set PWM_2_PWMUDB_genblk1_ctrlreg__16BIT_MASK_PERIOD_REG, CYREG_B0_UDB08_09_MSK
.set PWM_2_PWMUDB_genblk1_ctrlreg__16BIT_PERIOD_MASK_REG, CYREG_B0_UDB08_09_MSK
.set PWM_2_PWMUDB_genblk1_ctrlreg__16BIT_PERIOD_PERIOD_REG, CYREG_B0_UDB08_09_MSK
.set PWM_2_PWMUDB_genblk1_ctrlreg__7__MASK, 0x80
.set PWM_2_PWMUDB_genblk1_ctrlreg__7__POS, 7
.set PWM_2_PWMUDB_genblk1_ctrlreg__CONTROL_AUX_CTL_REG, CYREG_B0_UDB08_ACTL
.set PWM_2_PWMUDB_genblk1_ctrlreg__CONTROL_REG, CYREG_B0_UDB08_CTL
.set PWM_2_PWMUDB_genblk1_ctrlreg__CONTROL_ST_REG, CYREG_B0_UDB08_ST_CTL
.set PWM_2_PWMUDB_genblk1_ctrlreg__COUNT_REG, CYREG_B0_UDB08_CTL
.set PWM_2_PWMUDB_genblk1_ctrlreg__COUNT_ST_REG, CYREG_B0_UDB08_ST_CTL
.set PWM_2_PWMUDB_genblk1_ctrlreg__MASK, 0x80
.set PWM_2_PWMUDB_genblk1_ctrlreg__MASK_CTL_AUX_CTL_REG, CYREG_B0_UDB08_MSK_ACTL
.set PWM_2_PWMUDB_genblk1_ctrlreg__PER_CTL_AUX_CTL_REG, CYREG_B0_UDB08_MSK_ACTL
.set PWM_2_PWMUDB_genblk1_ctrlreg__PERIOD_REG, CYREG_B0_UDB08_MSK
.set PWM_2_PWMUDB_genblk8_stsreg__0__MASK, 0x01
.set PWM_2_PWMUDB_genblk8_stsreg__0__POS, 0
.set PWM_2_PWMUDB_genblk8_stsreg__16BIT_STATUS_AUX_CTL_REG, CYREG_B0_UDB08_09_ACTL
.set PWM_2_PWMUDB_genblk8_stsreg__16BIT_STATUS_REG, CYREG_B0_UDB08_09_ST
.set PWM_2_PWMUDB_genblk8_stsreg__2__MASK, 0x04
.set PWM_2_PWMUDB_genblk8_stsreg__2__POS, 2
.set PWM_2_PWMUDB_genblk8_stsreg__3__MASK, 0x08
.set PWM_2_PWMUDB_genblk8_stsreg__3__POS, 3
.set PWM_2_PWMUDB_genblk8_stsreg__MASK, 0x0D
.set PWM_2_PWMUDB_genblk8_stsreg__MASK_REG, CYREG_B0_UDB08_MSK
.set PWM_2_PWMUDB_genblk8_stsreg__MASK_ST_AUX_CTL_REG, CYREG_B0_UDB08_MSK_ACTL
.set PWM_2_PWMUDB_genblk8_stsreg__PER_ST_AUX_CTL_REG, CYREG_B0_UDB08_MSK_ACTL
.set PWM_2_PWMUDB_genblk8_stsreg__STATUS_AUX_CTL_REG, CYREG_B0_UDB08_ACTL
.set PWM_2_PWMUDB_genblk8_stsreg__STATUS_CNT_REG, CYREG_B0_UDB08_ST_CTL
.set PWM_2_PWMUDB_genblk8_stsreg__STATUS_CONTROL_REG, CYREG_B0_UDB08_ST_CTL
.set PWM_2_PWMUDB_genblk8_stsreg__STATUS_REG, CYREG_B0_UDB08_ST
.set PWM_2_PWMUDB_sP8_pwmdp_u0__16BIT_A0_REG, CYREG_B1_UDB08_09_A0
.set PWM_2_PWMUDB_sP8_pwmdp_u0__16BIT_A1_REG, CYREG_B1_UDB08_09_A1
.set PWM_2_PWMUDB_sP8_pwmdp_u0__16BIT_D0_REG, CYREG_B1_UDB08_09_D0
.set PWM_2_PWMUDB_sP8_pwmdp_u0__16BIT_D1_REG, CYREG_B1_UDB08_09_D1
.set PWM_2_PWMUDB_sP8_pwmdp_u0__16BIT_DP_AUX_CTL_REG, CYREG_B1_UDB08_09_ACTL
.set PWM_2_PWMUDB_sP8_pwmdp_u0__16BIT_F0_REG, CYREG_B1_UDB08_09_F0
.set PWM_2_PWMUDB_sP8_pwmdp_u0__16BIT_F1_REG, CYREG_B1_UDB08_09_F1
.set PWM_2_PWMUDB_sP8_pwmdp_u0__A0_A1_REG, CYREG_B1_UDB08_A0_A1
.set PWM_2_PWMUDB_sP8_pwmdp_u0__A0_REG, CYREG_B1_UDB08_A0
.set PWM_2_PWMUDB_sP8_pwmdp_u0__A1_REG, CYREG_B1_UDB08_A1
.set PWM_2_PWMUDB_sP8_pwmdp_u0__D0_D1_REG, CYREG_B1_UDB08_D0_D1
.set PWM_2_PWMUDB_sP8_pwmdp_u0__D0_REG, CYREG_B1_UDB08_D0
.set PWM_2_PWMUDB_sP8_pwmdp_u0__D1_REG, CYREG_B1_UDB08_D1
.set PWM_2_PWMUDB_sP8_pwmdp_u0__DP_AUX_CTL_REG, CYREG_B1_UDB08_ACTL
.set PWM_2_PWMUDB_sP8_pwmdp_u0__F0_F1_REG, CYREG_B1_UDB08_F0_F1
.set PWM_2_PWMUDB_sP8_pwmdp_u0__F0_REG, CYREG_B1_UDB08_F0
.set PWM_2_PWMUDB_sP8_pwmdp_u0__F1_REG, CYREG_B1_UDB08_F1

/* PWM_3 */
.set PWM_3_PWMUDB_genblk1_ctrlreg__16BIT_CONTROL_AUX_CTL_REG, CYREG_B1_UDB09_10_ACTL
.set PWM_3_PWMUDB_genblk1_ctrlreg__16BIT_CONTROL_CONTROL_REG, CYREG_B1_UDB09_10_CTL
.set PWM_3_PWMUDB_genblk1_ctrlreg__16BIT_CONTROL_COUNT_REG, CYREG_B1_UDB09_10_CTL
.set PWM_3_PWMUDB_genblk1_ctrlreg__16BIT_COUNT_CONTROL_REG, CYREG_B1_UDB09_10_CTL
.set PWM_3_PWMUDB_genblk1_ctrlreg__16BIT_COUNT_COUNT_REG, CYREG_B1_UDB09_10_CTL
.set PWM_3_PWMUDB_genblk1_ctrlreg__16BIT_MASK_MASK_REG, CYREG_B1_UDB09_10_MSK
.set PWM_3_PWMUDB_genblk1_ctrlreg__16BIT_MASK_PERIOD_REG, CYREG_B1_UDB09_10_MSK
.set PWM_3_PWMUDB_genblk1_ctrlreg__16BIT_PERIOD_MASK_REG, CYREG_B1_UDB09_10_MSK
.set PWM_3_PWMUDB_genblk1_ctrlreg__16BIT_PERIOD_PERIOD_REG, CYREG_B1_UDB09_10_MSK
.set PWM_3_PWMUDB_genblk1_ctrlreg__7__MASK, 0x80
.set PWM_3_PWMUDB_genblk1_ctrlreg__7__POS, 7
.set PWM_3_PWMUDB_genblk1_ctrlreg__CONTROL_AUX_CTL_REG, CYREG_B1_UDB09_ACTL
.set PWM_3_PWMUDB_genblk1_ctrlreg__CONTROL_REG, CYREG_B1_UDB09_CTL
.set PWM_3_PWMUDB_genblk1_ctrlreg__CONTROL_ST_REG, CYREG_B1_UDB09_ST_CTL
.set PWM_3_PWMUDB_genblk1_ctrlreg__COUNT_REG, CYREG_B1_UDB09_CTL
.set PWM_3_PWMUDB_genblk1_ctrlreg__COUNT_ST_REG, CYREG_B1_UDB09_ST_CTL
.set PWM_3_PWMUDB_genblk1_ctrlreg__MASK, 0x80
.set PWM_3_PWMUDB_genblk1_ctrlreg__MASK_CTL_AUX_CTL_REG, CYREG_B1_UDB09_MSK_ACTL
.set PWM_3_PWMUDB_genblk1_ctrlreg__PER_CTL_AUX_CTL_REG, CYREG_B1_UDB09_MSK_ACTL
.set PWM_3_PWMUDB_genblk1_ctrlreg__PERIOD_REG, CYREG_B1_UDB09_MSK
.set PWM_3_PWMUDB_genblk8_stsreg__0__MASK, 0x01
.set PWM_3_PWMUDB_genblk8_stsreg__0__POS, 0
.set PWM_3_PWMUDB_genblk8_stsreg__16BIT_STATUS_AUX_CTL_REG, CYREG_B1_UDB09_10_ACTL
.set PWM_3_PWMUDB_genblk8_stsreg__16BIT_STATUS_REG, CYREG_B1_UDB09_10_ST
.set PWM_3_PWMUDB_genblk8_stsreg__2__MASK, 0x04
.set PWM_3_PWMUDB_genblk8_stsreg__2__POS, 2
.set PWM_3_PWMUDB_genblk8_stsreg__3__MASK, 0x08
.set PWM_3_PWMUDB_genblk8_stsreg__3__POS, 3
.set PWM_3_PWMUDB_genblk8_stsreg__MASK, 0x0D
.set PWM_3_PWMUDB_genblk8_stsreg__MASK_REG, CYREG_B1_UDB09_MSK
.set PWM_3_PWMUDB_genblk8_stsreg__MASK_ST_AUX_CTL_REG, CYREG_B1_UDB09_MSK_ACTL
.set PWM_3_PWMUDB_genblk8_stsreg__PER_ST_AUX_CTL_REG, CYREG_B1_UDB09_MSK_ACTL
.set PWM_3_PWMUDB_genblk8_stsreg__STATUS_AUX_CTL_REG, CYREG_B1_UDB09_ACTL
.set PWM_3_PWMUDB_genblk8_stsreg__STATUS_CNT_REG, CYREG_B1_UDB09_ST_CTL
.set PWM_3_PWMUDB_genblk8_stsreg__STATUS_CONTROL_REG, CYREG_B1_UDB09_ST_CTL
.set PWM_3_PWMUDB_genblk8_stsreg__STATUS_REG, CYREG_B1_UDB09_ST
.set PWM_3_PWMUDB_sP8_pwmdp_u0__16BIT_A0_REG, CYREG_B1_UDB09_10_A0
.set PWM_3_PWMUDB_sP8_pwmdp_u0__16BIT_A1_REG, CYREG_B1_UDB09_10_A1
.set PWM_3_PWMUDB_sP8_pwmdp_u0__16BIT_D0_REG, CYREG_B1_UDB09_10_D0
.set PWM_3_PWMUDB_sP8_pwmdp_u0__16BIT_D1_REG, CYREG_B1_UDB09_10_D1
.set PWM_3_PWMUDB_sP8_pwmdp_u0__16BIT_DP_AUX_CTL_REG, CYREG_B1_UDB09_10_ACTL
.set PWM_3_PWMUDB_sP8_pwmdp_u0__16BIT_F0_REG, CYREG_B1_UDB09_10_F0
.set PWM_3_PWMUDB_sP8_pwmdp_u0__16BIT_F1_REG, CYREG_B1_UDB09_10_F1
.set PWM_3_PWMUDB_sP8_pwmdp_u0__A0_A1_REG, CYREG_B1_UDB09_A0_A1
.set PWM_3_PWMUDB_sP8_pwmdp_u0__A0_REG, CYREG_B1_UDB09_A0
.set PWM_3_PWMUDB_sP8_pwmdp_u0__A1_REG, CYREG_B1_UDB09_A1
.set PWM_3_PWMUDB_sP8_pwmdp_u0__D0_D1_REG, CYREG_B1_UDB09_D0_D1
.set PWM_3_PWMUDB_sP8_pwmdp_u0__D0_REG, CYREG_B1_UDB09_D0
.set PWM_3_PWMUDB_sP8_pwmdp_u0__D1_REG, CYREG_B1_UDB09_D1
.set PWM_3_PWMUDB_sP8_pwmdp_u0__DP_AUX_CTL_REG, CYREG_B1_UDB09_ACTL
.set PWM_3_PWMUDB_sP8_pwmdp_u0__F0_F1_REG, CYREG_B1_UDB09_F0_F1
.set PWM_3_PWMUDB_sP8_pwmdp_u0__F0_REG, CYREG_B1_UDB09_F0
.set PWM_3_PWMUDB_sP8_pwmdp_u0__F1_REG, CYREG_B1_UDB09_F1
.set PWM_3_PWMUDB_sP8_pwmdp_u0__MSK_DP_AUX_CTL_REG, CYREG_B1_UDB09_MSK_ACTL
.set PWM_3_PWMUDB_sP8_pwmdp_u0__PER_DP_AUX_CTL_REG, CYREG_B1_UDB09_MSK_ACTL

/* PWM_4 */
.set PWM_4_PWMUDB_genblk1_ctrlreg__16BIT_CONTROL_AUX_CTL_REG, CYREG_B1_UDB10_11_ACTL
.set PWM_4_PWMUDB_genblk1_ctrlreg__16BIT_CONTROL_CONTROL_REG, CYREG_B1_UDB10_11_CTL
.set PWM_4_PWMUDB_genblk1_ctrlreg__16BIT_CONTROL_COUNT_REG, CYREG_B1_UDB10_11_CTL
.set PWM_4_PWMUDB_genblk1_ctrlreg__16BIT_COUNT_CONTROL_REG, CYREG_B1_UDB10_11_CTL
.set PWM_4_PWMUDB_genblk1_ctrlreg__16BIT_COUNT_COUNT_REG, CYREG_B1_UDB10_11_CTL
.set PWM_4_PWMUDB_genblk1_ctrlreg__16BIT_MASK_MASK_REG, CYREG_B1_UDB10_11_MSK
.set PWM_4_PWMUDB_genblk1_ctrlreg__16BIT_MASK_PERIOD_REG, CYREG_B1_UDB10_11_MSK
.set PWM_4_PWMUDB_genblk1_ctrlreg__16BIT_PERIOD_MASK_REG, CYREG_B1_UDB10_11_MSK
.set PWM_4_PWMUDB_genblk1_ctrlreg__16BIT_PERIOD_PERIOD_REG, CYREG_B1_UDB10_11_MSK
.set PWM_4_PWMUDB_genblk1_ctrlreg__7__MASK, 0x80
.set PWM_4_PWMUDB_genblk1_ctrlreg__7__POS, 7
.set PWM_4_PWMUDB_genblk1_ctrlreg__CONTROL_AUX_CTL_REG, CYREG_B1_UDB10_ACTL
.set PWM_4_PWMUDB_genblk1_ctrlreg__CONTROL_REG, CYREG_B1_UDB10_CTL
.set PWM_4_PWMUDB_genblk1_ctrlreg__CONTROL_ST_REG, CYREG_B1_UDB10_ST_CTL
.set PWM_4_PWMUDB_genblk1_ctrlreg__COUNT_REG, CYREG_B1_UDB10_CTL
.set PWM_4_PWMUDB_genblk1_ctrlreg__COUNT_ST_REG, CYREG_B1_UDB10_ST_CTL
.set PWM_4_PWMUDB_genblk1_ctrlreg__MASK, 0x80
.set PWM_4_PWMUDB_genblk1_ctrlreg__MASK_CTL_AUX_CTL_REG, CYREG_B1_UDB10_MSK_ACTL
.set PWM_4_PWMUDB_genblk1_ctrlreg__PER_CTL_AUX_CTL_REG, CYREG_B1_UDB10_MSK_ACTL
.set PWM_4_PWMUDB_genblk1_ctrlreg__PERIOD_REG, CYREG_B1_UDB10_MSK
.set PWM_4_PWMUDB_genblk8_stsreg__0__MASK, 0x01
.set PWM_4_PWMUDB_genblk8_stsreg__0__POS, 0
.set PWM_4_PWMUDB_genblk8_stsreg__16BIT_STATUS_AUX_CTL_REG, CYREG_B1_UDB10_11_ACTL
.set PWM_4_PWMUDB_genblk8_stsreg__16BIT_STATUS_REG, CYREG_B1_UDB10_11_ST
.set PWM_4_PWMUDB_genblk8_stsreg__2__MASK, 0x04
.set PWM_4_PWMUDB_genblk8_stsreg__2__POS, 2
.set PWM_4_PWMUDB_genblk8_stsreg__3__MASK, 0x08
.set PWM_4_PWMUDB_genblk8_stsreg__3__POS, 3
.set PWM_4_PWMUDB_genblk8_stsreg__MASK, 0x0D
.set PWM_4_PWMUDB_genblk8_stsreg__MASK_REG, CYREG_B1_UDB10_MSK
.set PWM_4_PWMUDB_genblk8_stsreg__MASK_ST_AUX_CTL_REG, CYREG_B1_UDB10_MSK_ACTL
.set PWM_4_PWMUDB_genblk8_stsreg__PER_ST_AUX_CTL_REG, CYREG_B1_UDB10_MSK_ACTL
.set PWM_4_PWMUDB_genblk8_stsreg__STATUS_AUX_CTL_REG, CYREG_B1_UDB10_ACTL
.set PWM_4_PWMUDB_genblk8_stsreg__STATUS_CNT_REG, CYREG_B1_UDB10_ST_CTL
.set PWM_4_PWMUDB_genblk8_stsreg__STATUS_CONTROL_REG, CYREG_B1_UDB10_ST_CTL
.set PWM_4_PWMUDB_genblk8_stsreg__STATUS_REG, CYREG_B1_UDB10_ST
.set PWM_4_PWMUDB_sP8_pwmdp_u0__16BIT_A0_REG, CYREG_B1_UDB10_11_A0
.set PWM_4_PWMUDB_sP8_pwmdp_u0__16BIT_A1_REG, CYREG_B1_UDB10_11_A1
.set PWM_4_PWMUDB_sP8_pwmdp_u0__16BIT_D0_REG, CYREG_B1_UDB10_11_D0
.set PWM_4_PWMUDB_sP8_pwmdp_u0__16BIT_D1_REG, CYREG_B1_UDB10_11_D1
.set PWM_4_PWMUDB_sP8_pwmdp_u0__16BIT_DP_AUX_CTL_REG, CYREG_B1_UDB10_11_ACTL
.set PWM_4_PWMUDB_sP8_pwmdp_u0__16BIT_F0_REG, CYREG_B1_UDB10_11_F0
.set PWM_4_PWMUDB_sP8_pwmdp_u0__16BIT_F1_REG, CYREG_B1_UDB10_11_F1
.set PWM_4_PWMUDB_sP8_pwmdp_u0__A0_A1_REG, CYREG_B1_UDB10_A0_A1
.set PWM_4_PWMUDB_sP8_pwmdp_u0__A0_REG, CYREG_B1_UDB10_A0
.set PWM_4_PWMUDB_sP8_pwmdp_u0__A1_REG, CYREG_B1_UDB10_A1
.set PWM_4_PWMUDB_sP8_pwmdp_u0__D0_D1_REG, CYREG_B1_UDB10_D0_D1
.set PWM_4_PWMUDB_sP8_pwmdp_u0__D0_REG, CYREG_B1_UDB10_D0
.set PWM_4_PWMUDB_sP8_pwmdp_u0__D1_REG, CYREG_B1_UDB10_D1
.set PWM_4_PWMUDB_sP8_pwmdp_u0__DP_AUX_CTL_REG, CYREG_B1_UDB10_ACTL
.set PWM_4_PWMUDB_sP8_pwmdp_u0__F0_F1_REG, CYREG_B1_UDB10_F0_F1
.set PWM_4_PWMUDB_sP8_pwmdp_u0__F0_REG, CYREG_B1_UDB10_F0
.set PWM_4_PWMUDB_sP8_pwmdp_u0__F1_REG, CYREG_B1_UDB10_F1
.set PWM_4_PWMUDB_sP8_pwmdp_u0__MSK_DP_AUX_CTL_REG, CYREG_B1_UDB10_MSK_ACTL
.set PWM_4_PWMUDB_sP8_pwmdp_u0__PER_DP_AUX_CTL_REG, CYREG_B1_UDB10_MSK_ACTL

/* Reloj */
.set Reloj__CFG0, CYREG_CLKDIST_DCFG5_CFG0
.set Reloj__CFG1, CYREG_CLKDIST_DCFG5_CFG1
.set Reloj__CFG2, CYREG_CLKDIST_DCFG5_CFG2
.set Reloj__CFG2_SRC_SEL_MASK, 0x07
.set Reloj__INDEX, 0x05
.set Reloj__PM_ACT_CFG, CYREG_PM_ACT_CFG2
.set Reloj__PM_ACT_MSK, 0x20
.set Reloj__PM_STBY_CFG, CYREG_PM_STBY_CFG2
.set Reloj__PM_STBY_MSK, 0x20
.set Reloj_1__CFG0, CYREG_CLKDIST_DCFG3_CFG0
.set Reloj_1__CFG1, CYREG_CLKDIST_DCFG3_CFG1
.set Reloj_1__CFG2, CYREG_CLKDIST_DCFG3_CFG2
.set Reloj_1__CFG2_SRC_SEL_MASK, 0x07
.set Reloj_1__INDEX, 0x03
.set Reloj_1__PM_ACT_CFG, CYREG_PM_ACT_CFG2
.set Reloj_1__PM_ACT_MSK, 0x08
.set Reloj_1__PM_STBY_CFG, CYREG_PM_STBY_CFG2
.set Reloj_1__PM_STBY_MSK, 0x08
.set Reloj_2__CFG0, CYREG_CLKDIST_DCFG2_CFG0
.set Reloj_2__CFG1, CYREG_CLKDIST_DCFG2_CFG1
.set Reloj_2__CFG2, CYREG_CLKDIST_DCFG2_CFG2
.set Reloj_2__CFG2_SRC_SEL_MASK, 0x07
.set Reloj_2__INDEX, 0x02
.set Reloj_2__PM_ACT_CFG, CYREG_PM_ACT_CFG2
.set Reloj_2__PM_ACT_MSK, 0x04
.set Reloj_2__PM_STBY_CFG, CYREG_PM_STBY_CFG2
.set Reloj_2__PM_STBY_MSK, 0x04
.set Reloj_3__CFG0, CYREG_CLKDIST_DCFG4_CFG0
.set Reloj_3__CFG1, CYREG_CLKDIST_DCFG4_CFG1
.set Reloj_3__CFG2, CYREG_CLKDIST_DCFG4_CFG2
.set Reloj_3__CFG2_SRC_SEL_MASK, 0x07
.set Reloj_3__INDEX, 0x04
.set Reloj_3__PM_ACT_CFG, CYREG_PM_ACT_CFG2
.set Reloj_3__PM_ACT_MSK, 0x10
.set Reloj_3__PM_STBY_CFG, CYREG_PM_STBY_CFG2
.set Reloj_3__PM_STBY_MSK, 0x10

/* PWMS1_1 */
.set PWMS1_1__0__INTTYPE, CYREG_PICU1_INTTYPE7
.set PWMS1_1__0__MASK, 0x80
.set PWMS1_1__0__PC, CYREG_PRT1_PC7
.set PWMS1_1__0__PORT, 1
.set PWMS1_1__0__SHIFT, 7
.set PWMS1_1__AG, CYREG_PRT1_AG
.set PWMS1_1__AMUX, CYREG_PRT1_AMUX
.set PWMS1_1__BIE, CYREG_PRT1_BIE
.set PWMS1_1__BIT_MASK, CYREG_PRT1_BIT_MASK
.set PWMS1_1__BYP, CYREG_PRT1_BYP
.set PWMS1_1__CTL, CYREG_PRT1_CTL
.set PWMS1_1__DM0, CYREG_PRT1_DM0
.set PWMS1_1__DM1, CYREG_PRT1_DM1
.set PWMS1_1__DM2, CYREG_PRT1_DM2
.set PWMS1_1__DR, CYREG_PRT1_DR
.set PWMS1_1__INP_DIS, CYREG_PRT1_INP_DIS
.set PWMS1_1__INTTYPE_BASE, CYDEV_PICU_INTTYPE_PICU1_BASE
.set PWMS1_1__LCD_COM_SEG, CYREG_PRT1_LCD_COM_SEG
.set PWMS1_1__LCD_EN, CYREG_PRT1_LCD_EN
.set PWMS1_1__MASK, 0x80
.set PWMS1_1__PORT, 1
.set PWMS1_1__PRT, CYREG_PRT1_PRT
.set PWMS1_1__PRTDSI__CAPS_SEL, CYREG_PRT1_CAPS_SEL
.set PWMS1_1__PRTDSI__DBL_SYNC_IN, CYREG_PRT1_DBL_SYNC_IN
.set PWMS1_1__PRTDSI__OE_SEL0, CYREG_PRT1_OE_SEL0
.set PWMS1_1__PRTDSI__OE_SEL1, CYREG_PRT1_OE_SEL1
.set PWMS1_1__PRTDSI__OUT_SEL0, CYREG_PRT1_OUT_SEL0
.set PWMS1_1__PRTDSI__OUT_SEL1, CYREG_PRT1_OUT_SEL1
.set PWMS1_1__PRTDSI__SYNC_OUT, CYREG_PRT1_SYNC_OUT
.set PWMS1_1__PS, CYREG_PRT1_PS
.set PWMS1_1__SHIFT, 7
.set PWMS1_1__SLW, CYREG_PRT1_SLW

/* PWMS1_2 */
.set PWMS1_2__0__INTTYPE, CYREG_PICU1_INTTYPE6
.set PWMS1_2__0__MASK, 0x40
.set PWMS1_2__0__PC, CYREG_PRT1_PC6
.set PWMS1_2__0__PORT, 1
.set PWMS1_2__0__SHIFT, 6
.set PWMS1_2__AG, CYREG_PRT1_AG
.set PWMS1_2__AMUX, CYREG_PRT1_AMUX
.set PWMS1_2__BIE, CYREG_PRT1_BIE
.set PWMS1_2__BIT_MASK, CYREG_PRT1_BIT_MASK
.set PWMS1_2__BYP, CYREG_PRT1_BYP
.set PWMS1_2__CTL, CYREG_PRT1_CTL
.set PWMS1_2__DM0, CYREG_PRT1_DM0
.set PWMS1_2__DM1, CYREG_PRT1_DM1
.set PWMS1_2__DM2, CYREG_PRT1_DM2
.set PWMS1_2__DR, CYREG_PRT1_DR
.set PWMS1_2__INP_DIS, CYREG_PRT1_INP_DIS
.set PWMS1_2__INTTYPE_BASE, CYDEV_PICU_INTTYPE_PICU1_BASE
.set PWMS1_2__LCD_COM_SEG, CYREG_PRT1_LCD_COM_SEG
.set PWMS1_2__LCD_EN, CYREG_PRT1_LCD_EN
.set PWMS1_2__MASK, 0x40
.set PWMS1_2__PORT, 1
.set PWMS1_2__PRT, CYREG_PRT1_PRT
.set PWMS1_2__PRTDSI__CAPS_SEL, CYREG_PRT1_CAPS_SEL
.set PWMS1_2__PRTDSI__DBL_SYNC_IN, CYREG_PRT1_DBL_SYNC_IN
.set PWMS1_2__PRTDSI__OE_SEL0, CYREG_PRT1_OE_SEL0
.set PWMS1_2__PRTDSI__OE_SEL1, CYREG_PRT1_OE_SEL1
.set PWMS1_2__PRTDSI__OUT_SEL0, CYREG_PRT1_OUT_SEL0
.set PWMS1_2__PRTDSI__OUT_SEL1, CYREG_PRT1_OUT_SEL1
.set PWMS1_2__PRTDSI__SYNC_OUT, CYREG_PRT1_SYNC_OUT
.set PWMS1_2__PS, CYREG_PRT1_PS
.set PWMS1_2__SHIFT, 6
.set PWMS1_2__SLW, CYREG_PRT1_SLW

/* PWMS2_1 */
.set PWMS2_1__0__INTTYPE, CYREG_PICU1_INTTYPE5
.set PWMS2_1__0__MASK, 0x20
.set PWMS2_1__0__PC, CYREG_PRT1_PC5
.set PWMS2_1__0__PORT, 1
.set PWMS2_1__0__SHIFT, 5
.set PWMS2_1__AG, CYREG_PRT1_AG
.set PWMS2_1__AMUX, CYREG_PRT1_AMUX
.set PWMS2_1__BIE, CYREG_PRT1_BIE
.set PWMS2_1__BIT_MASK, CYREG_PRT1_BIT_MASK
.set PWMS2_1__BYP, CYREG_PRT1_BYP
.set PWMS2_1__CTL, CYREG_PRT1_CTL
.set PWMS2_1__DM0, CYREG_PRT1_DM0
.set PWMS2_1__DM1, CYREG_PRT1_DM1
.set PWMS2_1__DM2, CYREG_PRT1_DM2
.set PWMS2_1__DR, CYREG_PRT1_DR
.set PWMS2_1__INP_DIS, CYREG_PRT1_INP_DIS
.set PWMS2_1__INTTYPE_BASE, CYDEV_PICU_INTTYPE_PICU1_BASE
.set PWMS2_1__LCD_COM_SEG, CYREG_PRT1_LCD_COM_SEG
.set PWMS2_1__LCD_EN, CYREG_PRT1_LCD_EN
.set PWMS2_1__MASK, 0x20
.set PWMS2_1__PORT, 1
.set PWMS2_1__PRT, CYREG_PRT1_PRT
.set PWMS2_1__PRTDSI__CAPS_SEL, CYREG_PRT1_CAPS_SEL
.set PWMS2_1__PRTDSI__DBL_SYNC_IN, CYREG_PRT1_DBL_SYNC_IN
.set PWMS2_1__PRTDSI__OE_SEL0, CYREG_PRT1_OE_SEL0
.set PWMS2_1__PRTDSI__OE_SEL1, CYREG_PRT1_OE_SEL1
.set PWMS2_1__PRTDSI__OUT_SEL0, CYREG_PRT1_OUT_SEL0
.set PWMS2_1__PRTDSI__OUT_SEL1, CYREG_PRT1_OUT_SEL1
.set PWMS2_1__PRTDSI__SYNC_OUT, CYREG_PRT1_SYNC_OUT
.set PWMS2_1__PS, CYREG_PRT1_PS
.set PWMS2_1__SHIFT, 5
.set PWMS2_1__SLW, CYREG_PRT1_SLW

/* PWMS2_2 */
.set PWMS2_2__0__INTTYPE, CYREG_PICU1_INTTYPE4
.set PWMS2_2__0__MASK, 0x10
.set PWMS2_2__0__PC, CYREG_PRT1_PC4
.set PWMS2_2__0__PORT, 1
.set PWMS2_2__0__SHIFT, 4
.set PWMS2_2__AG, CYREG_PRT1_AG
.set PWMS2_2__AMUX, CYREG_PRT1_AMUX
.set PWMS2_2__BIE, CYREG_PRT1_BIE
.set PWMS2_2__BIT_MASK, CYREG_PRT1_BIT_MASK
.set PWMS2_2__BYP, CYREG_PRT1_BYP
.set PWMS2_2__CTL, CYREG_PRT1_CTL
.set PWMS2_2__DM0, CYREG_PRT1_DM0
.set PWMS2_2__DM1, CYREG_PRT1_DM1
.set PWMS2_2__DM2, CYREG_PRT1_DM2
.set PWMS2_2__DR, CYREG_PRT1_DR
.set PWMS2_2__INP_DIS, CYREG_PRT1_INP_DIS
.set PWMS2_2__INTTYPE_BASE, CYDEV_PICU_INTTYPE_PICU1_BASE
.set PWMS2_2__LCD_COM_SEG, CYREG_PRT1_LCD_COM_SEG
.set PWMS2_2__LCD_EN, CYREG_PRT1_LCD_EN
.set PWMS2_2__MASK, 0x10
.set PWMS2_2__PORT, 1
.set PWMS2_2__PRT, CYREG_PRT1_PRT
.set PWMS2_2__PRTDSI__CAPS_SEL, CYREG_PRT1_CAPS_SEL
.set PWMS2_2__PRTDSI__DBL_SYNC_IN, CYREG_PRT1_DBL_SYNC_IN
.set PWMS2_2__PRTDSI__OE_SEL0, CYREG_PRT1_OE_SEL0
.set PWMS2_2__PRTDSI__OE_SEL1, CYREG_PRT1_OE_SEL1
.set PWMS2_2__PRTDSI__OUT_SEL0, CYREG_PRT1_OUT_SEL0
.set PWMS2_2__PRTDSI__OUT_SEL1, CYREG_PRT1_OUT_SEL1
.set PWMS2_2__PRTDSI__SYNC_OUT, CYREG_PRT1_SYNC_OUT
.set PWMS2_2__PS, CYREG_PRT1_PS
.set PWMS2_2__SHIFT, 4
.set PWMS2_2__SLW, CYREG_PRT1_SLW

/* Temperatura */
.set Temperatura__0__INTTYPE, CYREG_PICU2_INTTYPE0
.set Temperatura__0__MASK, 0x01
.set Temperatura__0__PC, CYREG_PRT2_PC0
.set Temperatura__0__PORT, 2
.set Temperatura__0__SHIFT, 0
.set Temperatura__AG, CYREG_PRT2_AG
.set Temperatura__AMUX, CYREG_PRT2_AMUX
.set Temperatura__BIE, CYREG_PRT2_BIE
.set Temperatura__BIT_MASK, CYREG_PRT2_BIT_MASK
.set Temperatura__BYP, CYREG_PRT2_BYP
.set Temperatura__CTL, CYREG_PRT2_CTL
.set Temperatura__DM0, CYREG_PRT2_DM0
.set Temperatura__DM1, CYREG_PRT2_DM1
.set Temperatura__DM2, CYREG_PRT2_DM2
.set Temperatura__DR, CYREG_PRT2_DR
.set Temperatura__INP_DIS, CYREG_PRT2_INP_DIS
.set Temperatura__INTTYPE_BASE, CYDEV_PICU_INTTYPE_PICU2_BASE
.set Temperatura__LCD_COM_SEG, CYREG_PRT2_LCD_COM_SEG
.set Temperatura__LCD_EN, CYREG_PRT2_LCD_EN
.set Temperatura__MASK, 0x01
.set Temperatura__PORT, 2
.set Temperatura__PRT, CYREG_PRT2_PRT
.set Temperatura__PRTDSI__CAPS_SEL, CYREG_PRT2_CAPS_SEL
.set Temperatura__PRTDSI__DBL_SYNC_IN, CYREG_PRT2_DBL_SYNC_IN
.set Temperatura__PRTDSI__OE_SEL0, CYREG_PRT2_OE_SEL0
.set Temperatura__PRTDSI__OE_SEL1, CYREG_PRT2_OE_SEL1
.set Temperatura__PRTDSI__OUT_SEL0, CYREG_PRT2_OUT_SEL0
.set Temperatura__PRTDSI__OUT_SEL1, CYREG_PRT2_OUT_SEL1
.set Temperatura__PRTDSI__SYNC_OUT, CYREG_PRT2_SYNC_OUT
.set Temperatura__PS, CYREG_PRT2_PS
.set Temperatura__SHIFT, 0
.set Temperatura__SLW, CYREG_PRT2_SLW

/* Miscellaneous */
.set BCLK__BUS_CLK__HZ, 64000000
.set BCLK__BUS_CLK__KHZ, 64000
.set BCLK__BUS_CLK__MHZ, 64
.set CYDEV_CHIP_DIE_LEOPARD, 1
.set CYDEV_CHIP_DIE_PSOC4A, 18
.set CYDEV_CHIP_DIE_PSOC5LP, 2
.set CYDEV_CHIP_DIE_PSOC5TM, 3
.set CYDEV_CHIP_DIE_TMA4, 4
.set CYDEV_CHIP_DIE_UNKNOWN, 0
.set CYDEV_CHIP_FAMILY_FM0P, 5
.set CYDEV_CHIP_FAMILY_FM3, 6
.set CYDEV_CHIP_FAMILY_FM4, 7
.set CYDEV_CHIP_FAMILY_PSOC3, 1
.set CYDEV_CHIP_FAMILY_PSOC4, 2
.set CYDEV_CHIP_FAMILY_PSOC5, 3
.set CYDEV_CHIP_FAMILY_PSOC6, 4
.set CYDEV_CHIP_FAMILY_UNKNOWN, 0
.set CYDEV_CHIP_FAMILY_USED, CYDEV_CHIP_FAMILY_PSOC5
.set CYDEV_CHIP_JTAG_ID, 0x2E161069
.set CYDEV_CHIP_MEMBER_3A, 1
.set CYDEV_CHIP_MEMBER_4A, 18
.set CYDEV_CHIP_MEMBER_4D, 13
.set CYDEV_CHIP_MEMBER_4E, 6
.set CYDEV_CHIP_MEMBER_4F, 19
.set CYDEV_CHIP_MEMBER_4G, 4
.set CYDEV_CHIP_MEMBER_4H, 17
.set CYDEV_CHIP_MEMBER_4I, 23
.set CYDEV_CHIP_MEMBER_4J, 14
.set CYDEV_CHIP_MEMBER_4K, 15
.set CYDEV_CHIP_MEMBER_4L, 22
.set CYDEV_CHIP_MEMBER_4M, 21
.set CYDEV_CHIP_MEMBER_4N, 10
.set CYDEV_CHIP_MEMBER_4O, 7
.set CYDEV_CHIP_MEMBER_4P, 20
.set CYDEV_CHIP_MEMBER_4Q, 12
.set CYDEV_CHIP_MEMBER_4R, 8
.set CYDEV_CHIP_MEMBER_4S, 11
.set CYDEV_CHIP_MEMBER_4T, 9
.set CYDEV_CHIP_MEMBER_4U, 5
.set CYDEV_CHIP_MEMBER_4V, 16
.set CYDEV_CHIP_MEMBER_5A, 3
.set CYDEV_CHIP_MEMBER_5B, 2
.set CYDEV_CHIP_MEMBER_6A, 24
.set CYDEV_CHIP_MEMBER_FM3, 28
.set CYDEV_CHIP_MEMBER_FM4, 29
.set CYDEV_CHIP_MEMBER_PDL_FM0P_TYPE1, 25
.set CYDEV_CHIP_MEMBER_PDL_FM0P_TYPE2, 26
.set CYDEV_CHIP_MEMBER_PDL_FM0P_TYPE3, 27
.set CYDEV_CHIP_MEMBER_UNKNOWN, 0
.set CYDEV_CHIP_MEMBER_USED, CYDEV_CHIP_MEMBER_5B
.set CYDEV_CHIP_DIE_EXPECT, CYDEV_CHIP_MEMBER_USED
.set CYDEV_CHIP_DIE_ACTUAL, CYDEV_CHIP_DIE_EXPECT
.set CYDEV_CHIP_REV_LEOPARD_ES1, 0
.set CYDEV_CHIP_REV_LEOPARD_ES2, 1
.set CYDEV_CHIP_REV_LEOPARD_ES3, 3
.set CYDEV_CHIP_REV_LEOPARD_PRODUCTION, 3
.set CYDEV_CHIP_REV_PSOC4A_ES0, 17
.set CYDEV_CHIP_REV_PSOC4A_PRODUCTION, 17
.set CYDEV_CHIP_REV_PSOC5LP_ES0, 0
.set CYDEV_CHIP_REV_PSOC5LP_PRODUCTION, 0
.set CYDEV_CHIP_REV_PSOC5TM_ES0, 0
.set CYDEV_CHIP_REV_PSOC5TM_ES1, 1
.set CYDEV_CHIP_REV_PSOC5TM_PRODUCTION, 1
.set CYDEV_CHIP_REV_TMA4_ES, 17
.set CYDEV_CHIP_REV_TMA4_ES2, 33
.set CYDEV_CHIP_REV_TMA4_PRODUCTION, 17
.set CYDEV_CHIP_REVISION_3A_ES1, 0
.set CYDEV_CHIP_REVISION_3A_ES2, 1
.set CYDEV_CHIP_REVISION_3A_ES3, 3
.set CYDEV_CHIP_REVISION_3A_PRODUCTION, 3
.set CYDEV_CHIP_REVISION_4A_ES0, 17
.set CYDEV_CHIP_REVISION_4A_PRODUCTION, 17
.set CYDEV_CHIP_REVISION_4D_PRODUCTION, 0
.set CYDEV_CHIP_REVISION_4E_CCG2_NO_USBPD, 0
.set CYDEV_CHIP_REVISION_4E_PRODUCTION, 0
.set CYDEV_CHIP_REVISION_4F_PRODUCTION, 0
.set CYDEV_CHIP_REVISION_4F_PRODUCTION_256DMA, 0
.set CYDEV_CHIP_REVISION_4F_PRODUCTION_256K, 0
.set CYDEV_CHIP_REVISION_4G_ES, 17
.set CYDEV_CHIP_REVISION_4G_ES2, 33
.set CYDEV_CHIP_REVISION_4G_PRODUCTION, 17
.set CYDEV_CHIP_REVISION_4H_PRODUCTION, 0
.set CYDEV_CHIP_REVISION_4I_PRODUCTION, 0
.set CYDEV_CHIP_REVISION_4J_PRODUCTION, 0
.set CYDEV_CHIP_REVISION_4K_PRODUCTION, 0
.set CYDEV_CHIP_REVISION_4L_PRODUCTION, 0
.set CYDEV_CHIP_REVISION_4M_PRODUCTION, 0
.set CYDEV_CHIP_REVISION_4N_PRODUCTION, 0
.set CYDEV_CHIP_REVISION_4O_PRODUCTION, 0
.set CYDEV_CHIP_REVISION_4P_PRODUCTION, 0
.set CYDEV_CHIP_REVISION_4Q_PRODUCTION, 0
.set CYDEV_CHIP_REVISION_4R_PRODUCTION, 0
.set CYDEV_CHIP_REVISION_4S_PRODUCTION, 0
.set CYDEV_CHIP_REVISION_4T_PRODUCTION, 0
.set CYDEV_CHIP_REVISION_4U_PRODUCTION, 0
.set CYDEV_CHIP_REVISION_4V_PRODUCTION, 0
.set CYDEV_CHIP_REVISION_5A_ES0, 0
.set CYDEV_CHIP_REVISION_5A_ES1, 1
.set CYDEV_CHIP_REVISION_5A_PRODUCTION, 1
.set CYDEV_CHIP_REVISION_5B_ES0, 0
.set CYDEV_CHIP_REVISION_5B_PRODUCTION, 0
.set CYDEV_CHIP_REVISION_6A_ES, 17
.set CYDEV_CHIP_REVISION_6A_NO_UDB, 33
.set CYDEV_CHIP_REVISION_6A_PRODUCTION, 33
.set CYDEV_CHIP_REVISION_FM3_PRODUCTION, 0
.set CYDEV_CHIP_REVISION_FM4_PRODUCTION, 0
.set CYDEV_CHIP_REVISION_PDL_FM0P_TYPE1_PRODUCTION, 0
.set CYDEV_CHIP_REVISION_PDL_FM0P_TYPE2_PRODUCTION, 0
.set CYDEV_CHIP_REVISION_PDL_FM0P_TYPE3_PRODUCTION, 0
.set CYDEV_CHIP_REVISION_USED, CYDEV_CHIP_REVISION_5B_PRODUCTION
.set CYDEV_CHIP_REV_EXPECT, CYDEV_CHIP_REVISION_USED
.set CYDEV_CONFIG_FASTBOOT_ENABLED, 1
.set CYDEV_CONFIG_UNUSED_IO_AllowButWarn, 0
.set CYDEV_CONFIG_UNUSED_IO, CYDEV_CONFIG_UNUSED_IO_AllowButWarn
.set CYDEV_CONFIG_UNUSED_IO_AllowWithInfo, 1
.set CYDEV_CONFIG_UNUSED_IO_Disallowed, 2
.set CYDEV_CONFIGURATION_COMPRESSED, 1
.set CYDEV_CONFIGURATION_DMA, 0
.set CYDEV_CONFIGURATION_ECC, 1
.set CYDEV_CONFIGURATION_IMOENABLED, CYDEV_CONFIG_FASTBOOT_ENABLED
.set CYDEV_CONFIGURATION_MODE_COMPRESSED, 0
.set CYDEV_CONFIGURATION_MODE, CYDEV_CONFIGURATION_MODE_COMPRESSED
.set CYDEV_CONFIGURATION_MODE_DMA, 2
.set CYDEV_CONFIGURATION_MODE_UNCOMPRESSED, 1
.set CYDEV_DEBUG_ENABLE_MASK, 0x20
.set CYDEV_DEBUG_ENABLE_REGISTER, CYREG_MLOGIC_DEBUG
.set CYDEV_DEBUGGING_DPS_Disable, 3
.set CYDEV_DEBUGGING_DPS_JTAG_4, 1
.set CYDEV_DEBUGGING_DPS_JTAG_5, 0
.set CYDEV_DEBUGGING_DPS_SWD, 2
.set CYDEV_DEBUGGING_DPS_SWD_SWV, 6
.set CYDEV_DEBUGGING_DPS, CYDEV_DEBUGGING_DPS_SWD_SWV
.set CYDEV_DEBUGGING_ENABLE, 1
.set CYDEV_DEBUGGING_XRES, 0
.set CYDEV_DMA_CHANNELS_AVAILABLE, 24
.set CYDEV_ECC_ENABLE, 0
.set CYDEV_HEAP_SIZE, 0x400
.set CYDEV_INSTRUCT_CACHE_ENABLED, 1
.set CYDEV_INTR_RISING, 0x00000001
.set CYDEV_IS_EXPORTING_CODE, 0
.set CYDEV_IS_IMPORTING_CODE, 0
.set CYDEV_PROJ_TYPE, 0
.set CYDEV_PROJ_TYPE_BOOTLOADER, 1
.set CYDEV_PROJ_TYPE_LAUNCHER, 5
.set CYDEV_PROJ_TYPE_LOADABLE, 2
.set CYDEV_PROJ_TYPE_LOADABLEANDBOOTLOADER, 4
.set CYDEV_PROJ_TYPE_MULTIAPPBOOTLOADER, 3
.set CYDEV_PROJ_TYPE_STANDARD, 0
.set CYDEV_PROTECTION_ENABLE, 0
.set CYDEV_STACK_SIZE, 0x1000
.set CYDEV_USB_CLK_OSC_LOCKING_ENABLED_AT_PWR_UP, 1
.set CYDEV_USE_BUNDLED_CMSIS, 1
.set CYDEV_VARIABLE_VDDA, 0
.set CYDEV_VDDA_MV, 5000
.set CYDEV_VDDD_MV, 5000
.set CYDEV_VDDIO0_MV, 5000
.set CYDEV_VDDIO1_MV, 5000
.set CYDEV_VDDIO2_MV, 5000
.set CYDEV_VDDIO3_MV, 5000
.set CYDEV_VIO0_MV, 5000
.set CYDEV_VIO1_MV, 5000
.set CYDEV_VIO2_MV, 5000
.set CYDEV_VIO3_MV, 5000
.set CYIPBLOCK_ARM_CM3_VERSION, 0
.set CYIPBLOCK_P3_ANAIF_VERSION, 0
.set CYIPBLOCK_P3_CAN_VERSION, 0
.set CYIPBLOCK_P3_CAPSENSE_VERSION, 0
.set CYIPBLOCK_P3_COMP_VERSION, 0
.set CYIPBLOCK_P3_DECIMATOR_VERSION, 0
.set CYIPBLOCK_P3_DFB_VERSION, 0
.set CYIPBLOCK_P3_DMA_VERSION, 0
.set CYIPBLOCK_P3_DRQ_VERSION, 0
.set CYIPBLOCK_P3_DSM_VERSION, 0
.set CYIPBLOCK_P3_EMIF_VERSION, 0
.set CYIPBLOCK_P3_I2C_VERSION, 0
.set CYIPBLOCK_P3_LCD_VERSION, 0
.set CYIPBLOCK_P3_LPF_VERSION, 0
.set CYIPBLOCK_P3_OPAMP_VERSION, 0
.set CYIPBLOCK_P3_PM_VERSION, 0
.set CYIPBLOCK_P3_SCCT_VERSION, 0
.set CYIPBLOCK_P3_TIMER_VERSION, 0
.set CYIPBLOCK_P3_USB_VERSION, 0
.set CYIPBLOCK_P3_VIDAC_VERSION, 0
.set CYIPBLOCK_P3_VREF_VERSION, 0
.set CYIPBLOCK_S8_GPIO_VERSION, 0
.set CYIPBLOCK_S8_IRQ_VERSION, 0
.set CYIPBLOCK_S8_SAR_VERSION, 0
.set CYIPBLOCK_S8_SIO_VERSION, 0
.set CYIPBLOCK_S8_UDB_VERSION, 0
.set DMA_CHANNELS_USED__MASK0, 0x00000000
.set CYDEV_BOOTLOADER_ENABLE, 0
.endif
