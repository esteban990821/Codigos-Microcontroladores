//Librerias 
#include <Wire.h>


#include <Adafruit_GFX.h>
#include <Adafruit_SSD1306.h>

#define ANCHO 128
#define ALTO 64
#define OLED_RESET 4


Adafruit_SSD1306 oled(ANCHO, ALTO, &Wire, OLED_RESET);// caracteristica de la pantalla a utilizar.

const unsigned char PROGMEM coronavirus19 [] = {//imagen covid-19
0x00, 0x00, 0x00, 0x00, 0x00, 0x00, 0x00, 0x00, 0x00, 0x00, 0x00, 0x00, 0x00, 0x00, 0x00, 0x00,
0x00, 0x00, 0x00, 0x00, 0x00, 0x00, 0x00, 0x00, 0x00, 0x00, 0x00, 0x00, 0x00, 0x00, 0x00, 0x00,
0x00, 0x00, 0x00, 0x00, 0x00, 0x00, 0x00, 0x00, 0x00, 0x00, 0x00, 0x00, 0x00, 0x00, 0x00, 0x00,
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0x00, 0x00, 0x00, 0x00, 0x00, 0x00, 0x00, 0x00, 0x00, 0x00, 0x00, 0x00, 0x00, 0x00, 0x00, 0x00
};
const unsigned char PROGMEM Termometro1 [] = {//imagen termometro
0x00, 0x00, 0x00, 0x00, 0x00, 0x00, 0x00, 0x00, 0x00, 0x00, 0x00, 0x00, 0x00, 0x00, 0x00, 0x00,
0x00, 0x00, 0x00, 0x00, 0x00, 0x00, 0x00, 0x00, 0x00, 0x00, 0x00, 0x00, 0x00, 0x00, 0x00, 0x00,
0x00, 0x00, 0x00, 0x00, 0x00, 0x00, 0x00, 0x00, 0x00, 0x00, 0x00, 0x00, 0x00, 0x00, 0x00, 0x00,
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0x00, 0x00, 0x00, 0x00, 0x00, 0x00, 0x00, 0x00, 0x00, 0x00, 0x00, 0x00, 0x00, 0x00, 0x00, 0x00
};
const unsigned char PROGMEM IAE [] = {//imagen LOGO
0x00, 0x00, 0x00, 0x00, 0x00, 0x00, 0x00, 0x00, 0x00, 0x00, 0x00, 0x00, 0x00, 0x00, 0x00, 0x00,
0x00, 0x00, 0x00, 0x00, 0x00, 0x00, 0x00, 0x00, 0x00, 0x00, 0x00, 0x00, 0x00, 0x00, 0x00, 0x00,
0x00, 0x00, 0x00, 0x00, 0x00, 0x00, 0x00, 0x00, 0x00, 0x00, 0x00, 0x00, 0x00, 0x00, 0x00, 0x00,
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0x00, 0x0F, 0xFF, 0xFF, 0xFF, 0xFF, 0xFF, 0xFF, 0xFF, 0xFF, 0xFF, 0xFF, 0xFF, 0xFF, 0xE0, 0x00
};

const unsigned char PROGMEM grados [] = {//imagen Grados  
0x00, 0x00, 0x00, 0x00, 0x00, 0x00, 0x00, 0x00, 0x00, 0x00, 0x00, 0x00, 0x00, 0x00, 0x00, 0x00,
0x00, 0x00, 0x00, 0x00, 0x00, 0x00, 0x00, 0x00, 0x00, 0x00, 0x00, 0x00, 0x00, 0x00, 0x00, 0x00,
0x00, 0x00, 0x00, 0x00, 0x00, 0x00, 0x00, 0x00, 0x00, 0x00, 0x00, 0x00, 0x00, 0x00, 0x00, 0x00,
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0x00, 0x00, 0x00, 0x00, 0x00, 0x00, 0x00, 0x00, 0x00, 0x00, 0x00, 0x00, 0x00, 0x00, 0x00, 0x00
};



//inicializacion de varaibles 
unsigned char Re_buf[11],counter=0;
unsigned char sign=0;
int value=0,pin=13,pinA=7,pinB=8,pinC=12,dato=0,cont=0,c=0;
float guardado=0,Temperatura=0;
float TO=0,TA=0;
    
  
void setup() {
  Wire.begin();
  oled.begin(SSD1306_SWITCHCAPVCC, 0x3C);
  pinMode(pin, INPUT);
  pinMode(pinA, OUTPUT);
  pinMode(pinB, OUTPUT);
  pinMode(pinC, OUTPUT);
  Serial.begin(115200);
  Serial.write(0XA5);
  Serial.write(0X45);
  Serial.write(0XEA);
}


void loop()
  
  {unsigned char i=0,sum=0;
    
    if(c==0){OLED();}
    
           
           
  if(sign)
  {
     sign=0;
     for(i=0;i<8;i++)
      sum+=Re_buf[i];
     if(sum==Re_buf[i] )
     {      TO=(float)(Re_buf[4]<<8|Re_buf[5])/100;
            oled.clearDisplay();
            oled.drawRect(0,0,127,15,WHITE);
            oled.setCursor(10,3 );
            oled.setTextSize(1);
            oled.setTextColor(WHITE);
            oled.print("La Temperatura es:");
            oled.drawBitmap(15,13, Termometro1 ,128,64,WHITE);
            oled.drawBitmap(10,5, grados ,128,64,WHITE);
            dato=digitalRead(pin);
            
            if(dato==0){
            digitalWrite(pinC, HIGH);
            Temperatura=TO+4;
            oled.setCursor(42,30 );
            oled.setTextSize(2);
            oled.setTextColor(WHITE);
            oled.print(Temperatura);    
            oled.display();
            delay(100);
            }
            else{
            digitalWrite(pinC, LOW);
            oled.setCursor(42,30 );
            oled.setTextSize(2);
            oled.setTextColor(WHITE);
            oled.print(Temperatura);           
            oled.display();
              }
             if(Temperatura>=35.7){
              digitalWrite(pinA, HIGH);
              digitalWrite(pinB, LOW);
              }
              if(Temperatura<35.7){
              digitalWrite(pinB, HIGH);
              digitalWrite(pinA, LOW);
              }            
             
          
           
           //TA=(float)(Re_buf[6]<<8|Re_buf[7])/100;
           //Serial.print("TA:");
           //Serial.println(TA);
   }
  }
 
  
  
  }  
 
  void serialEvent() {
  while (Serial.available()) {
    Re_buf[counter]=(unsigned char)Serial.read();
    if(counter==0&&Re_buf[0]!=0x5A) return;
    counter++;
    if(counter==9)
    {
       counter=0;
       sign=1;
    }
  }
}
void OLED(){
 oled.clearDisplay();
 for(int i=1; i<  oled.height()*1.3;i++){
    oled.drawCircle(oled.width()/2, oled.height()/2, i, WHITE);
    oled.drawCircle(oled.width()/2, oled.height()/2, i-15, WHITE);
    oled.drawCircle(oled.width()/2, oled.height()/2, i-30, WHITE);
    oled.drawCircle(oled.width()/2, oled.height()/2, i-45, WHITE);
    oled.drawCircle(oled.width()/2, oled.height()/2, i-60, WHITE);
    oled.display();
    delay(40);
    oled.clearDisplay();}

    oled.clearDisplay();  
    oled.drawBitmap(0,0, IAE ,128,64,WHITE);
    oled.display();
    delay(2000);
    
    oled.clearDisplay();
    oled.setCursor(10,3 );
    oled.setTextSize(1);
    oled.setTextColor(WHITE);
    oled.print("COVID-19, PROTEGETE");    
    oled.drawBitmap(0,5, coronavirus19 ,128,64,WHITE);
    oled.display();
    delay(2000);
    oled.clearDisplay();     
    c=2;
   }
